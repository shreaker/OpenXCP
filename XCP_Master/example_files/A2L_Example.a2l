/* @@@@ File written by CANAPE_VERSION 14 0 34 @@@@ */ ASAP2_VERSION 1 70
/begin PROJECT New ""
/begin MODULE New ""
/begin MOD_COMMON "" BYTE_ORDER MSB_LAST ALIGNMENT_BYTE 1 ALIGNMENT_WORD 2 ALIGNMENT_LONG 4 ALIGNMENT_INT64 8 ALIGNMENT_FLOAT32_IEEE 4 ALIGNMENT_FLOAT64_IEEE 8 /end MOD_COMMON
/begin IF_DATA XCP
 /begin PROTOCOL_LAYER 0x0100 0x3E8 0x2710 0x00 0x00 0x00 0x00 0x00 0x8 0x50 BYTE_ORDER_MSB_LAST ADDRESS_GRANULARITY_BYTE OPTIONAL_CMD ALLOC_ODT_ENTRY OPTIONAL_CMD ALLOC_ODT OPTIONAL_CMD ALLOC_DAQ OPTIONAL_CMD FREE_DAQ OPTIONAL_CMD GET_DAQ_RESOLUTION_INFO OPTIONAL_CMD GET_DAQ_PROCESSOR_INFO OPTIONAL_CMD START_STOP_SYNCH OPTIONAL_CMD START_STOP_DAQ_LIST OPTIONAL_CMD GET_DAQ_LIST_MODE OPTIONAL_CMD SET_DAQ_LIST_MODE OPTIONAL_CMD WRITE_DAQ OPTIONAL_CMD SET_DAQ_PTR OPTIONAL_CMD CLEAR_DAQ_LIST OPTIONAL_CMD DOWNLOAD OPTIONAL_CMD SHORT_UPLOAD OPTIONAL_CMD UPLOAD OPTIONAL_CMD SET_MTA OPTIONAL_CMD GET_COMM_MODE_INFO /end PROTOCOL_LAYER
 /begin DAQ DYNAMIC 0x00 0x2 0x00 OPTIMISATION_TYPE_DEFAULT ADDRESS_EXTENSION_FREE IDENTIFICATION_FIELD_TYPE_ABSOLUTE GRANULARITY_ODT_ENTRY_SIZE_DAQ_BYTE 0x07 OVERLOAD_INDICATION_PID PRESCALER_SUPPORTED /begin EVENT "10ms" "10ms" 0x0 DAQ 0xFF 0x0A 0x06 0x00 /end EVENT /begin EVENT "100ms" "100ms" 0x1 DAQ 0xFF 0x64 0x06 0x00 /end EVENT /end DAQ
 /begin DAQ DYNAMIC 0x00 0x01 0x00 OPTIMISATION_TYPE_DEFAULT ADDRESS_EXTENSION_FREE IDENTIFICATION_FIELD_TYPE_ABSOLUTE GRANULARITY_ODT_ENTRY_SIZE_DAQ_BYTE 0x07 OVERLOAD_INDICATION_PID PRESCALER_SUPPORTED
  /begin EVENT "TestCounterEvent" "TestCount" 0x01 DAQ 0xFF 0x01 0x07 0x00 /end EVENT
 /end DAQ
 /begin PAG 0x00 /end PAG
 /begin PGM PGM_MODE_ABSOLUTE 0x00 0x00 /end PGM
 /* OpenXCP Ethernet */
 /begin XCP_ON_UDP_IP 0x0100 0x15B3 ADDRESS "192.168.0.128" /end XCP_ON_UDP_IP
/end IF_DATA
/begin MOD_PAR "" /end MOD_PAR
/* OpenXCP MEASUREMENT / CHARACTERISTIC */
/begin MEASUREMENT backgroundlightmin "backgroundlightmin" A_UINT64 NO_COMPU_METHOD 0 0 -1000 1000 READ_WRITE ECU_ADDRESS 0x70012474 FORMAT "%.15" PHYS_UNIT "km/h" /end MEASUREMENT
/begin MEASUREMENT backgroundlightmax "backgroundlightmax" A_UINT64 NO_COMPU_METHOD 0 0 -1000 1000 READ_WRITE ECU_ADDRESS 0x70012470 FORMAT "%.15" PHYS_UNIT "km/h" /end MEASUREMENT
/begin MEASUREMENT backgroundlightdelta "backgroundlightdelta" A_UINT64 NO_COMPU_METHOD 0 0 -1000 1000 READ_WRITE ECU_ADDRESS 0x7001246C FORMAT "%.15" PHYS_UNIT "km/h" /end MEASUREMENT
/begin MEASUREMENT backgroundlightsize "backgroundlightsize" A_UINT64 NO_COMPU_METHOD 0 0 -1000 1000 READ_WRITE ECU_ADDRESS 0x70012468 FORMAT "%.15" PHYS_UNIT "km/h" /end MEASUREMENT
/begin MEASUREMENT testCounter "Vehicle speedl" UBYTE NO_COMPU_METHOD 0 0 0 255 READ_WRITE ECU_ADDRESS 0x70000E8C FORMAT "%.15" PHYS_UNIT "km/h" /end MEASUREMENT
/begin MEASUREMENT testCounterNegative "signed int" SLONG NO_COMPU_METHOD 0 0 -1000 1000 READ_WRITE ECU_ADDRESS 0x700008C8 FORMAT "%.15" PHYS_UNIT "km/h" /end MEASUREMENT
/begin CHARACTERISTIC modifyMe "ModifyMe Comment" VALUE 0x700008C4 __A_UINT64_S 0 NO_COMPU_METHOD 0 50000 FORMAT "%.15" PHYS_UNIT "minutes" STEP_SIZE 2 /end CHARACTERISTIC
/begin MEASUREMENT testArray._0_ "array test" UWORD NO_COMPU_METHOD 0 0 0 255 READ_WRITE ECU_ADDRESS 0x70000E78 FORMAT "%.15" PHYS_UNIT "km/h" /end MEASUREMENT
/begin MEASUREMENT testArray._1_ "array test" UWORD NO_COMPU_METHOD 0 0 0 255 READ_WRITE ECU_ADDRESS 0x70000E7A FORMAT "%.15" PHYS_UNIT "km/h" /end MEASUREMENT
/begin MEASUREMENT testArray._2_ "array test" UWORD NO_COMPU_METHOD 0 0 0 255 READ_WRITE ECU_ADDRESS 0x70000E7C FORMAT "%.15" PHYS_UNIT "km/h" /end MEASUREMENT
/begin MEASUREMENT testArray._3_ "array test" UWORD NO_COMPU_METHOD 0 0 0 255 READ_WRITE ECU_ADDRESS 0x70000E7E FORMAT "%.15" PHYS_UNIT "km/h" /end MEASUREMENT
/begin MEASUREMENT testArray._4_ "array test" UWORD NO_COMPU_METHOD 0 0 0 255 READ_WRITE ECU_ADDRESS 0x70000E80 FORMAT "%.15" PHYS_UNIT "km/h" /end MEASUREMENT
/begin MEASUREMENT testArray._5_ "array test" UWORD NO_COMPU_METHOD 0 0 0 255 READ_WRITE ECU_ADDRESS 0x70000E82 FORMAT "%.15" PHYS_UNIT "km/h" /end MEASUREMENT
/begin MEASUREMENT testArray._6_ "array test" UWORD NO_COMPU_METHOD 0 0 0 255 READ_WRITE ECU_ADDRESS 0x70000E84 FORMAT "%.15" PHYS_UNIT "km/h" /end MEASUREMENT
/begin MEASUREMENT testArray._7_ "array test" UWORD NO_COMPU_METHOD 0 0 0 255 READ_WRITE ECU_ADDRESS 0x70000E86 FORMAT "%.15" PHYS_UNIT "km/h" /end MEASUREMENT
/begin MEASUREMENT testArray._8_ "array test" UWORD NO_COMPU_METHOD 0 0 0 255 READ_WRITE ECU_ADDRESS 0x70000E88 FORMAT "%.15" PHYS_UNIT "km/h" /end MEASUREMENT
/begin MEASUREMENT testArray._9_ "array test" UWORD NO_COMPU_METHOD 0 0 0 255 READ_WRITE ECU_ADDRESS 0x70000E8A FORMAT "%.15" PHYS_UNIT "km/h" /end MEASUREMENT
/begin MEASUREMENT gSendBuffer._0_ "array gSendBuffer" UBYTE NO_COMPU_METHOD 0 0 0 255 READ_WRITE ECU_ADDRESS 0x700010E4 FORMAT "%.15" PHYS_UNIT "km/h" /end MEASUREMENT
/begin MEASUREMENT gSendBuffer._1_ "array gSendBuffer" UBYTE NO_COMPU_METHOD 0 0 0 255 READ_WRITE ECU_ADDRESS 0x700010E5 FORMAT "%.15" PHYS_UNIT "km/h" /end MEASUREMENT
/begin MEASUREMENT gSendBuffer._2_ "array gSendBuffer" UBYTE NO_COMPU_METHOD 0 0 0 255 READ_WRITE ECU_ADDRESS 0x700010E6 FORMAT "%.15" PHYS_UNIT "km/h" /end MEASUREMENT
/begin MEASUREMENT gSendBuffer._3_ "array gSendBuffer" UBYTE NO_COMPU_METHOD 0 0 0 255 READ_WRITE ECU_ADDRESS 0x700010E7 FORMAT "%.15" PHYS_UNIT "km/h" /end MEASUREMENT
/begin MEASUREMENT gSendBuffer._4_ "array gSendBuffer" UBYTE NO_COMPU_METHOD 0 0 0 255 READ_WRITE ECU_ADDRESS 0x700010E8 FORMAT "%.15" PHYS_UNIT "km/h" /end MEASUREMENT
/begin MEASUREMENT gSendBuffer._5_ "array gSendBuffer" UBYTE NO_COMPU_METHOD 0 0 0 255 READ_WRITE ECU_ADDRESS 0x700010E9 FORMAT "%.15" PHYS_UNIT "km/h" /end MEASUREMENT
/begin MEASUREMENT gSendBuffer._6_ "array gSendBuffer" UBYTE NO_COMPU_METHOD 0 0 0 255 READ_WRITE ECU_ADDRESS 0x700010EA FORMAT "%.15" PHYS_UNIT "km/h" /end MEASUREMENT
/begin MEASUREMENT gSendBuffer._7_ "array gSendBuffer" UBYTE NO_COMPU_METHOD 0 0 0 255 READ_WRITE ECU_ADDRESS 0x700010EB FORMAT "%.15" PHYS_UNIT "km/h" /end MEASUREMENT
/begin MEASUREMENT gSendBuffer._8_ "array gSendBuffer" UBYTE NO_COMPU_METHOD 0 0 0 255 READ_WRITE ECU_ADDRESS 0x700010EC FORMAT "%.15" PHYS_UNIT "km/h" /end MEASUREMENT
/begin MEASUREMENT gSendBuffer._9_ "array gSendBuffer" UBYTE NO_COMPU_METHOD 0 0 0 255 READ_WRITE ECU_ADDRESS 0x700010ED FORMAT "%.15" PHYS_UNIT "km/h" /end MEASUREMENT
/begin MEASUREMENT gSendBuffer._10_ "array gSendBuffer" UBYTE NO_COMPU_METHOD 0 0 0 255 READ_WRITE ECU_ADDRESS 0x700010EE FORMAT "%.15" PHYS_UNIT "km/h" /end MEASUREMENT
/begin MEASUREMENT gSendBuffer._11_ "array gSendBuffer" UBYTE NO_COMPU_METHOD 0 0 0 255 READ_WRITE ECU_ADDRESS 0x700010EF FORMAT "%.15" PHYS_UNIT "km/h" /end MEASUREMENT
/begin MEASUREMENT gSendBuffer._12_ "array gSendBuffer" UBYTE NO_COMPU_METHOD 0 0 0 255 READ_WRITE ECU_ADDRESS 0x700010F0 FORMAT "%.15" PHYS_UNIT "km/h" /end MEASUREMENT
/begin MEASUREMENT gSendBuffer._13_ "array gSendBuffer" UBYTE NO_COMPU_METHOD 0 0 0 255 READ_WRITE ECU_ADDRESS 0x700010F1 FORMAT "%.15" PHYS_UNIT "km/h" /end MEASUREMENT
/begin MEASUREMENT gSendBuffer._14_ "array gSendBuffer" UBYTE NO_COMPU_METHOD 0 0 0 255 READ_WRITE ECU_ADDRESS 0x700010F2 FORMAT "%.15" PHYS_UNIT "km/h" /end MEASUREMENT
/begin MEASUREMENT gSendBuffer._15_ "array gSendBuffer" UBYTE NO_COMPU_METHOD 0 0 0 255 READ_WRITE ECU_ADDRESS 0x700010F3 FORMAT "%.15" PHYS_UNIT "km/h" /end MEASUREMENT
/begin MEASUREMENT gSendBuffer._16_ "array gSendBuffer" UBYTE NO_COMPU_METHOD 0 0 0 255 READ_WRITE ECU_ADDRESS 0x700010F4 FORMAT "%.15" PHYS_UNIT "km/h" /end MEASUREMENT
/begin MEASUREMENT gSendBuffer._17_ "array gSendBuffer" UBYTE NO_COMPU_METHOD 0 0 0 255 READ_WRITE ECU_ADDRESS 0x700010F5 FORMAT "%.15" PHYS_UNIT "km/h" /end MEASUREMENT
/begin MEASUREMENT gSendBuffer._18_ "array gSendBuffer" UBYTE NO_COMPU_METHOD 0 0 0 255 READ_WRITE ECU_ADDRESS 0x700010F6 FORMAT "%.15" PHYS_UNIT "km/h" /end MEASUREMENT
/begin MEASUREMENT gSendBuffer._19_ "array gSendBuffer" UBYTE NO_COMPU_METHOD 0 0 0 255 READ_WRITE ECU_ADDRESS 0x700010F7 FORMAT "%.15" PHYS_UNIT "km/h" /end MEASUREMENT
/begin MEASUREMENT gSendBuffer._20_ "array gSendBuffer" UBYTE NO_COMPU_METHOD 0 0 0 255 READ_WRITE ECU_ADDRESS 0x700010F8 FORMAT "%.15" PHYS_UNIT "km/h" /end MEASUREMENT
/begin MEASUREMENT gSendBuffer._21_ "array gSendBuffer" UBYTE NO_COMPU_METHOD 0 0 0 255 READ_WRITE ECU_ADDRESS 0x700010F9 FORMAT "%.15" PHYS_UNIT "km/h" /end MEASUREMENT
/begin MEASUREMENT gSendBuffer._22_ "array gSendBuffer" UBYTE NO_COMPU_METHOD 0 0 0 255 READ_WRITE ECU_ADDRESS 0x700010FA FORMAT "%.15" PHYS_UNIT "km/h" /end MEASUREMENT
/begin MEASUREMENT gSendBuffer._23_ "array gSendBuffer" UBYTE NO_COMPU_METHOD 0 0 0 255 READ_WRITE ECU_ADDRESS 0x700010FB FORMAT "%.15" PHYS_UNIT "km/h" /end MEASUREMENT
/begin MEASUREMENT gSendBuffer._24_ "array gSendBuffer" UBYTE NO_COMPU_METHOD 0 0 0 255 READ_WRITE ECU_ADDRESS 0x700010FC FORMAT "%.15" PHYS_UNIT "km/h" /end MEASUREMENT
/begin MEASUREMENT gSendBuffer._25_ "array gSendBuffer" UBYTE NO_COMPU_METHOD 0 0 0 255 READ_WRITE ECU_ADDRESS 0x700010FD FORMAT "%.15" PHYS_UNIT "km/h" /end MEASUREMENT
/begin MEASUREMENT gSendBuffer._26_ "array gSendBuffer" UBYTE NO_COMPU_METHOD 0 0 0 255 READ_WRITE ECU_ADDRESS 0x700010FE FORMAT "%.15" PHYS_UNIT "km/h" /end MEASUREMENT
/begin MEASUREMENT gSendBuffer._27_ "array gSendBuffer" UBYTE NO_COMPU_METHOD 0 0 0 255 READ_WRITE ECU_ADDRESS 0x700010FF FORMAT "%.15" PHYS_UNIT "km/h" /end MEASUREMENT
/begin MEASUREMENT gSendBuffer._28_ "array gSendBuffer" UBYTE NO_COMPU_METHOD 0 0 0 255 READ_WRITE ECU_ADDRESS 0x70001100 FORMAT "%.15" PHYS_UNIT "km/h" /end MEASUREMENT
/begin MEASUREMENT gSendBuffer._29_ "array gSendBuffer" UBYTE NO_COMPU_METHOD 0 0 0 255 READ_WRITE ECU_ADDRESS 0x70001101 FORMAT "%.15" PHYS_UNIT "km/h" /end MEASUREMENT
/begin MEASUREMENT gSendBuffer._30_ "array gSendBuffer" UBYTE NO_COMPU_METHOD 0 0 0 255 READ_WRITE ECU_ADDRESS 0x70001102 FORMAT "%.15" PHYS_UNIT "km/h" /end MEASUREMENT
/begin MEASUREMENT gSendBuffer._31_ "array gSendBuffer" UBYTE NO_COMPU_METHOD 0 0 0 255 READ_WRITE ECU_ADDRESS 0x70001103 FORMAT "%.15" PHYS_UNIT "km/h" /end MEASUREMENT
/begin MEASUREMENT gSendBuffer._32_ "array gSendBuffer" UBYTE NO_COMPU_METHOD 0 0 0 255 READ_WRITE ECU_ADDRESS 0x70001104 FORMAT "%.15" PHYS_UNIT "km/h" /end MEASUREMENT
/begin MEASUREMENT gSendBuffer._33_ "array gSendBuffer" UBYTE NO_COMPU_METHOD 0 0 0 255 READ_WRITE ECU_ADDRESS 0x70001105 FORMAT "%.15" PHYS_UNIT "km/h" /end MEASUREMENT
/begin MEASUREMENT gSendBuffer._34_ "array gSendBuffer" UBYTE NO_COMPU_METHOD 0 0 0 255 READ_WRITE ECU_ADDRESS 0x70001106 FORMAT "%.15" PHYS_UNIT "km/h" /end MEASUREMENT
/begin MEASUREMENT gSendBuffer._35_ "array gSendBuffer" UBYTE NO_COMPU_METHOD 0 0 0 255 READ_WRITE ECU_ADDRESS 0x70001107 FORMAT "%.15" PHYS_UNIT "km/h" /end MEASUREMENT
/begin MEASUREMENT gSendBuffer._36_ "array gSendBuffer" UBYTE NO_COMPU_METHOD 0 0 0 255 READ_WRITE ECU_ADDRESS 0x70001108 FORMAT "%.15" PHYS_UNIT "km/h" /end MEASUREMENT
/begin MEASUREMENT gSendBuffer._37_ "array gSendBuffer" UBYTE NO_COMPU_METHOD 0 0 0 255 READ_WRITE ECU_ADDRESS 0x70001109 FORMAT "%.15" PHYS_UNIT "km/h" /end MEASUREMENT
/begin MEASUREMENT gSendBuffer._38_ "array gSendBuffer" UBYTE NO_COMPU_METHOD 0 0 0 255 READ_WRITE ECU_ADDRESS 0x7000110A FORMAT "%.15" PHYS_UNIT "km/h" /end MEASUREMENT
/begin MEASUREMENT gSendBuffer._39_ "array gSendBuffer" UBYTE NO_COMPU_METHOD 0 0 0 255 READ_WRITE ECU_ADDRESS 0x7000110B FORMAT "%.15" PHYS_UNIT "km/h" /end MEASUREMENT
/begin MEASUREMENT gSendBuffer._40_ "array gSendBuffer" UBYTE NO_COMPU_METHOD 0 0 0 255 READ_WRITE ECU_ADDRESS 0x7000110C FORMAT "%.15" PHYS_UNIT "km/h" /end MEASUREMENT
/begin MEASUREMENT gSendBuffer._41_ "array gSendBuffer" UBYTE NO_COMPU_METHOD 0 0 0 255 READ_WRITE ECU_ADDRESS 0x7000110D FORMAT "%.15" PHYS_UNIT "km/h" /end MEASUREMENT
/begin MEASUREMENT gSendBuffer._42_ "array gSendBuffer" UBYTE NO_COMPU_METHOD 0 0 0 255 READ_WRITE ECU_ADDRESS 0x7000110E FORMAT "%.15" PHYS_UNIT "km/h" /end MEASUREMENT
/begin MEASUREMENT gSendBuffer._43_ "array gSendBuffer" UBYTE NO_COMPU_METHOD 0 0 0 255 READ_WRITE ECU_ADDRESS 0x7000110F FORMAT "%.15" PHYS_UNIT "km/h" /end MEASUREMENT
/begin MEASUREMENT gSendBuffer._44_ "array gSendBuffer" UBYTE NO_COMPU_METHOD 0 0 0 255 READ_WRITE ECU_ADDRESS 0x70001110 FORMAT "%.15" PHYS_UNIT "km/h" /end MEASUREMENT
/begin MEASUREMENT gSendBuffer._45_ "array gSendBuffer" UBYTE NO_COMPU_METHOD 0 0 0 255 READ_WRITE ECU_ADDRESS 0x70001111 FORMAT "%.15" PHYS_UNIT "km/h" /end MEASUREMENT
/begin MEASUREMENT gSendBuffer._46_ "array gSendBuffer" UBYTE NO_COMPU_METHOD 0 0 0 255 READ_WRITE ECU_ADDRESS 0x70001112 FORMAT "%.15" PHYS_UNIT "km/h" /end MEASUREMENT
/begin MEASUREMENT gSendBuffer._47_ "array gSendBuffer" UBYTE NO_COMPU_METHOD 0 0 0 255 READ_WRITE ECU_ADDRESS 0x70001113 FORMAT "%.15" PHYS_UNIT "km/h" /end MEASUREMENT
/begin MEASUREMENT gSendBuffer._48_ "array gSendBuffer" UBYTE NO_COMPU_METHOD 0 0 0 255 READ_WRITE ECU_ADDRESS 0x70001114 FORMAT "%.15" PHYS_UNIT "km/h" /end MEASUREMENT
/begin MEASUREMENT gSendBuffer._49_ "array gSendBuffer" UBYTE NO_COMPU_METHOD 0 0 0 255 READ_WRITE ECU_ADDRESS 0x70001115 FORMAT "%.15" PHYS_UNIT "km/h" /end MEASUREMENT
/begin MEASUREMENT gSendBuffer._50_ "array gSendBuffer" UBYTE NO_COMPU_METHOD 0 0 0 255 READ_WRITE ECU_ADDRESS 0x70001116 FORMAT "%.15" PHYS_UNIT "km/h" /end MEASUREMENT
/begin MEASUREMENT gSendBuffer._51_ "array gSendBuffer" UBYTE NO_COMPU_METHOD 0 0 0 255 READ_WRITE ECU_ADDRESS 0x70001117 FORMAT "%.15" PHYS_UNIT "km/h" /end MEASUREMENT
/begin MEASUREMENT gSendBuffer._52_ "array gSendBuffer" UBYTE NO_COMPU_METHOD 0 0 0 255 READ_WRITE ECU_ADDRESS 0x70001118 FORMAT "%.15" PHYS_UNIT "km/h" /end MEASUREMENT
/begin MEASUREMENT gSendBuffer._53_ "array gSendBuffer" UBYTE NO_COMPU_METHOD 0 0 0 255 READ_WRITE ECU_ADDRESS 0x70001119 FORMAT "%.15" PHYS_UNIT "km/h" /end MEASUREMENT
/begin MEASUREMENT gSendBuffer._54_ "array gSendBuffer" UBYTE NO_COMPU_METHOD 0 0 0 255 READ_WRITE ECU_ADDRESS 0x7000111A FORMAT "%.15" PHYS_UNIT "km/h" /end MEASUREMENT
/begin MEASUREMENT gSendBuffer._55_ "array gSendBuffer" UBYTE NO_COMPU_METHOD 0 0 0 255 READ_WRITE ECU_ADDRESS 0x7000111B FORMAT "%.15" PHYS_UNIT "km/h" /end MEASUREMENT
/begin MEASUREMENT gSendBuffer._56_ "array gSendBuffer" UBYTE NO_COMPU_METHOD 0 0 0 255 READ_WRITE ECU_ADDRESS 0x7000111C FORMAT "%.15" PHYS_UNIT "km/h" /end MEASUREMENT
/begin MEASUREMENT gSendBuffer._57_ "array gSendBuffer" UBYTE NO_COMPU_METHOD 0 0 0 255 READ_WRITE ECU_ADDRESS 0x7000111D FORMAT "%.15" PHYS_UNIT "km/h" /end MEASUREMENT
/begin MEASUREMENT gSendBuffer._58_ "array gSendBuffer" UBYTE NO_COMPU_METHOD 0 0 0 255 READ_WRITE ECU_ADDRESS 0x7000111E FORMAT "%.15" PHYS_UNIT "km/h" /end MEASUREMENT
/begin MEASUREMENT gSendBuffer._59_ "array gSendBuffer" UBYTE NO_COMPU_METHOD 0 0 0 255 READ_WRITE ECU_ADDRESS 0x7000111F FORMAT "%.15" PHYS_UNIT "km/h" /end MEASUREMENT
/begin MEASUREMENT gSendBuffer._60_ "array gSendBuffer" UBYTE NO_COMPU_METHOD 0 0 0 255 READ_WRITE ECU_ADDRESS 0x70001120 FORMAT "%.15" PHYS_UNIT "km/h" /end MEASUREMENT
/begin MEASUREMENT gSendBuffer._61_ "array gSendBuffer" UBYTE NO_COMPU_METHOD 0 0 0 255 READ_WRITE ECU_ADDRESS 0x70001121 FORMAT "%.15" PHYS_UNIT "km/h" /end MEASUREMENT
/begin MEASUREMENT gSendBuffer._62_ "array gSendBuffer" UBYTE NO_COMPU_METHOD 0 0 0 255 READ_WRITE ECU_ADDRESS 0x70001122 FORMAT "%.15" PHYS_UNIT "km/h" /end MEASUREMENT
/begin MEASUREMENT gSendBuffer._63_ "array gSendBuffer" UBYTE NO_COMPU_METHOD 0 0 0 255 READ_WRITE ECU_ADDRESS 0x70001123 FORMAT "%.15" PHYS_UNIT "km/h" /end MEASUREMENT
/begin MEASUREMENT gSendBuffer._64_ "array gSendBuffer" UBYTE NO_COMPU_METHOD 0 0 0 255 READ_WRITE ECU_ADDRESS 0x70001124 FORMAT "%.15" PHYS_UNIT "km/h" /end MEASUREMENT
/begin MEASUREMENT gSendBuffer._65_ "array gSendBuffer" UBYTE NO_COMPU_METHOD 0 0 0 255 READ_WRITE ECU_ADDRESS 0x70001125 FORMAT "%.15" PHYS_UNIT "km/h" /end MEASUREMENT
/begin MEASUREMENT gSendBuffer._66_ "array gSendBuffer" UBYTE NO_COMPU_METHOD 0 0 0 255 READ_WRITE ECU_ADDRESS 0x70001126 FORMAT "%.15" PHYS_UNIT "km/h" /end MEASUREMENT
/begin MEASUREMENT gSendBuffer._67_ "array gSendBuffer" UBYTE NO_COMPU_METHOD 0 0 0 255 READ_WRITE ECU_ADDRESS 0x70001127 FORMAT "%.15" PHYS_UNIT "km/h" /end MEASUREMENT
/begin MEASUREMENT gSendBuffer._68_ "array gSendBuffer" UBYTE NO_COMPU_METHOD 0 0 0 255 READ_WRITE ECU_ADDRESS 0x70001128 FORMAT "%.15" PHYS_UNIT "km/h" /end MEASUREMENT
/begin MEASUREMENT gSendBuffer._69_ "array gSendBuffer" UBYTE NO_COMPU_METHOD 0 0 0 255 READ_WRITE ECU_ADDRESS 0x70001129 FORMAT "%.15" PHYS_UNIT "km/h" /end MEASUREMENT
/begin MEASUREMENT gSendBuffer._70_ "array gSendBuffer" UBYTE NO_COMPU_METHOD 0 0 0 255 READ_WRITE ECU_ADDRESS 0x7000112A FORMAT "%.15" PHYS_UNIT "km/h" /end MEASUREMENT
/begin MEASUREMENT gSendBuffer._71_ "array gSendBuffer" UBYTE NO_COMPU_METHOD 0 0 0 255 READ_WRITE ECU_ADDRESS 0x7000112B FORMAT "%.15" PHYS_UNIT "km/h" /end MEASUREMENT
/begin MEASUREMENT gSendBuffer._72_ "array gSendBuffer" UBYTE NO_COMPU_METHOD 0 0 0 255 READ_WRITE ECU_ADDRESS 0x7000112C FORMAT "%.15" PHYS_UNIT "km/h" /end MEASUREMENT
/begin MEASUREMENT gSendBuffer._73_ "array gSendBuffer" UBYTE NO_COMPU_METHOD 0 0 0 255 READ_WRITE ECU_ADDRESS 0x7000112D FORMAT "%.15" PHYS_UNIT "km/h" /end MEASUREMENT
/begin MEASUREMENT gSendBuffer._74_ "array gSendBuffer" UBYTE NO_COMPU_METHOD 0 0 0 255 READ_WRITE ECU_ADDRESS 0x7000112E FORMAT "%.15" PHYS_UNIT "km/h" /end MEASUREMENT
/begin MEASUREMENT gSendBuffer._75_ "array gSendBuffer" UBYTE NO_COMPU_METHOD 0 0 0 255 READ_WRITE ECU_ADDRESS 0x7000112F FORMAT "%.15" PHYS_UNIT "km/h" /end MEASUREMENT
/begin MEASUREMENT gSendBuffer._76_ "array gSendBuffer" UBYTE NO_COMPU_METHOD 0 0 0 255 READ_WRITE ECU_ADDRESS 0x70001130 FORMAT "%.15" PHYS_UNIT "km/h" /end MEASUREMENT
/begin MEASUREMENT gSendBuffer._77_ "array gSendBuffer" UBYTE NO_COMPU_METHOD 0 0 0 255 READ_WRITE ECU_ADDRESS 0x70001131 FORMAT "%.15" PHYS_UNIT "km/h" /end MEASUREMENT
/begin MEASUREMENT gSendBuffer._78_ "array gSendBuffer" UBYTE NO_COMPU_METHOD 0 0 0 255 READ_WRITE ECU_ADDRESS 0x70001132 FORMAT "%.15" PHYS_UNIT "km/h" /end MEASUREMENT
/begin MEASUREMENT gSendBuffer._79_ "array gSendBuffer" UBYTE NO_COMPU_METHOD 0 0 0 255 READ_WRITE ECU_ADDRESS 0x70001133 FORMAT "%.15" PHYS_UNIT "km/h" /end MEASUREMENT
/begin MEASUREMENT gSendBuffer._80_ "array gSendBuffer" UBYTE NO_COMPU_METHOD 0 0 0 255 READ_WRITE ECU_ADDRESS 0x70001134 FORMAT "%.15" PHYS_UNIT "km/h" /end MEASUREMENT
/begin MEASUREMENT gSendBuffer._81_ "array gSendBuffer" UBYTE NO_COMPU_METHOD 0 0 0 255 READ_WRITE ECU_ADDRESS 0x70001135 FORMAT "%.15" PHYS_UNIT "km/h" /end MEASUREMENT
/begin MEASUREMENT gSendBuffer._82_ "array gSendBuffer" UBYTE NO_COMPU_METHOD 0 0 0 255 READ_WRITE ECU_ADDRESS 0x70001136 FORMAT "%.15" PHYS_UNIT "km/h" /end MEASUREMENT
/begin MEASUREMENT gSendBuffer._83_ "array gSendBuffer" UBYTE NO_COMPU_METHOD 0 0 0 255 READ_WRITE ECU_ADDRESS 0x70001137 FORMAT "%.15" PHYS_UNIT "km/h" /end MEASUREMENT
/begin MEASUREMENT gSendBuffer._84_ "array gSendBuffer" UBYTE NO_COMPU_METHOD 0 0 0 255 READ_WRITE ECU_ADDRESS 0x70001138 FORMAT "%.15" PHYS_UNIT "km/h" /end MEASUREMENT
/begin MEASUREMENT gSendBuffer._85_ "array gSendBuffer" UBYTE NO_COMPU_METHOD 0 0 0 255 READ_WRITE ECU_ADDRESS 0x70001139 FORMAT "%.15" PHYS_UNIT "km/h" /end MEASUREMENT
/begin MEASUREMENT gSendBuffer._86_ "array gSendBuffer" UBYTE NO_COMPU_METHOD 0 0 0 255 READ_WRITE ECU_ADDRESS 0x7000113A FORMAT "%.15" PHYS_UNIT "km/h" /end MEASUREMENT
/begin MEASUREMENT gSendBuffer._87_ "array gSendBuffer" UBYTE NO_COMPU_METHOD 0 0 0 255 READ_WRITE ECU_ADDRESS 0x7000113B FORMAT "%.15" PHYS_UNIT "km/h" /end MEASUREMENT
/begin MEASUREMENT gSendBuffer._88_ "array gSendBuffer" UBYTE NO_COMPU_METHOD 0 0 0 255 READ_WRITE ECU_ADDRESS 0x7000113C FORMAT "%.15" PHYS_UNIT "km/h" /end MEASUREMENT
/begin MEASUREMENT gSendBuffer._89_ "array gSendBuffer" UBYTE NO_COMPU_METHOD 0 0 0 255 READ_WRITE ECU_ADDRESS 0x7000113D FORMAT "%.15" PHYS_UNIT "km/h" /end MEASUREMENT
/begin MEASUREMENT gSendBuffer._90_ "array gSendBuffer" UBYTE NO_COMPU_METHOD 0 0 0 255 READ_WRITE ECU_ADDRESS 0x7000113E FORMAT "%.15" PHYS_UNIT "km/h" /end MEASUREMENT
/begin MEASUREMENT gSendBuffer._91_ "array gSendBuffer" UBYTE NO_COMPU_METHOD 0 0 0 255 READ_WRITE ECU_ADDRESS 0x7000113F FORMAT "%.15" PHYS_UNIT "km/h" /end MEASUREMENT
/begin MEASUREMENT gSendBuffer._92_ "array gSendBuffer" UBYTE NO_COMPU_METHOD 0 0 0 255 READ_WRITE ECU_ADDRESS 0x70001140 FORMAT "%.15" PHYS_UNIT "km/h" /end MEASUREMENT
/begin MEASUREMENT gSendBuffer._93_ "array gSendBuffer" UBYTE NO_COMPU_METHOD 0 0 0 255 READ_WRITE ECU_ADDRESS 0x70001141 FORMAT "%.15" PHYS_UNIT "km/h" /end MEASUREMENT
/begin MEASUREMENT gSendBuffer._94_ "array gSendBuffer" UBYTE NO_COMPU_METHOD 0 0 0 255 READ_WRITE ECU_ADDRESS 0x70001142 FORMAT "%.15" PHYS_UNIT "km/h" /end MEASUREMENT
/begin MEASUREMENT gSendBuffer._95_ "array gSendBuffer" UBYTE NO_COMPU_METHOD 0 0 0 255 READ_WRITE ECU_ADDRESS 0x70001143 FORMAT "%.15" PHYS_UNIT "km/h" /end MEASUREMENT
/begin MEASUREMENT gSendBuffer._96_ "array gSendBuffer" UBYTE NO_COMPU_METHOD 0 0 0 255 READ_WRITE ECU_ADDRESS 0x70001144 FORMAT "%.15" PHYS_UNIT "km/h" /end MEASUREMENT
/begin MEASUREMENT gSendBuffer._97_ "array gSendBuffer" UBYTE NO_COMPU_METHOD 0 0 0 255 READ_WRITE ECU_ADDRESS 0x70001145 FORMAT "%.15" PHYS_UNIT "km/h" /end MEASUREMENT
/begin MEASUREMENT gSendBuffer._98_ "array gSendBuffer" UBYTE NO_COMPU_METHOD 0 0 0 255 READ_WRITE ECU_ADDRESS 0x70001146 FORMAT "%.15" PHYS_UNIT "km/h" /end MEASUREMENT
/begin MEASUREMENT gSendBuffer._99_ "array gSendBuffer" UBYTE NO_COMPU_METHOD 0 0 0 255 READ_WRITE ECU_ADDRESS 0x70001147 FORMAT "%.15" PHYS_UNIT "km/h" /end MEASUREMENT
/begin MEASUREMENT gSendBuffer._100_ "array gSendBuffer" UBYTE NO_COMPU_METHOD 0 0 0 255 READ_WRITE ECU_ADDRESS 0x70001148 FORMAT "%.15" PHYS_UNIT "km/h" /end MEASUREMENT
/begin MEASUREMENT gSendBuffer._101_ "array gSendBuffer" UBYTE NO_COMPU_METHOD 0 0 0 255 READ_WRITE ECU_ADDRESS 0x70001149 FORMAT "%.15" PHYS_UNIT "km/h" /end MEASUREMENT
/begin MEASUREMENT gSendBuffer._102_ "array gSendBuffer" UBYTE NO_COMPU_METHOD 0 0 0 255 READ_WRITE ECU_ADDRESS 0x7000114A FORMAT "%.15" PHYS_UNIT "km/h" /end MEASUREMENT
/begin MEASUREMENT gSendBuffer._103_ "array gSendBuffer" UBYTE NO_COMPU_METHOD 0 0 0 255 READ_WRITE ECU_ADDRESS 0x7000114B FORMAT "%.15" PHYS_UNIT "km/h" /end MEASUREMENT
/begin MEASUREMENT gSendBuffer._104_ "array gSendBuffer" UBYTE NO_COMPU_METHOD 0 0 0 255 READ_WRITE ECU_ADDRESS 0x7000114C FORMAT "%.15" PHYS_UNIT "km/h" /end MEASUREMENT
/begin MEASUREMENT gSendBuffer._105_ "array gSendBuffer" UBYTE NO_COMPU_METHOD 0 0 0 255 READ_WRITE ECU_ADDRESS 0x7000114D FORMAT "%.15" PHYS_UNIT "km/h" /end MEASUREMENT
/begin MEASUREMENT gSendBuffer._106_ "array gSendBuffer" UBYTE NO_COMPU_METHOD 0 0 0 255 READ_WRITE ECU_ADDRESS 0x7000114E FORMAT "%.15" PHYS_UNIT "km/h" /end MEASUREMENT
/begin MEASUREMENT gSendBuffer._107_ "array gSendBuffer" UBYTE NO_COMPU_METHOD 0 0 0 255 READ_WRITE ECU_ADDRESS 0x7000114F FORMAT "%.15" PHYS_UNIT "km/h" /end MEASUREMENT
/begin MEASUREMENT gSendBuffer._108_ "array gSendBuffer" UBYTE NO_COMPU_METHOD 0 0 0 255 READ_WRITE ECU_ADDRESS 0x70001150 FORMAT "%.15" PHYS_UNIT "km/h" /end MEASUREMENT
/begin MEASUREMENT gSendBuffer._109_ "array gSendBuffer" UBYTE NO_COMPU_METHOD 0 0 0 255 READ_WRITE ECU_ADDRESS 0x70001151 FORMAT "%.15" PHYS_UNIT "km/h" /end MEASUREMENT
/begin MEASUREMENT gSendBuffer._110_ "array gSendBuffer" UBYTE NO_COMPU_METHOD 0 0 0 255 READ_WRITE ECU_ADDRESS 0x70001152 FORMAT "%.15" PHYS_UNIT "km/h" /end MEASUREMENT
/begin MEASUREMENT gSendBuffer._111_ "array gSendBuffer" UBYTE NO_COMPU_METHOD 0 0 0 255 READ_WRITE ECU_ADDRESS 0x70001153 FORMAT "%.15" PHYS_UNIT "km/h" /end MEASUREMENT
/begin MEASUREMENT gSendBuffer._112_ "array gSendBuffer" UBYTE NO_COMPU_METHOD 0 0 0 255 READ_WRITE ECU_ADDRESS 0x70001154 FORMAT "%.15" PHYS_UNIT "km/h" /end MEASUREMENT
/begin MEASUREMENT gSendBuffer._113_ "array gSendBuffer" UBYTE NO_COMPU_METHOD 0 0 0 255 READ_WRITE ECU_ADDRESS 0x70001155 FORMAT "%.15" PHYS_UNIT "km/h" /end MEASUREMENT
/begin MEASUREMENT gSendBuffer._114_ "array gSendBuffer" UBYTE NO_COMPU_METHOD 0 0 0 255 READ_WRITE ECU_ADDRESS 0x70001156 FORMAT "%.15" PHYS_UNIT "km/h" /end MEASUREMENT
/begin MEASUREMENT gSendBuffer._115_ "array gSendBuffer" UBYTE NO_COMPU_METHOD 0 0 0 255 READ_WRITE ECU_ADDRESS 0x70001157 FORMAT "%.15" PHYS_UNIT "km/h" /end MEASUREMENT
/begin MEASUREMENT gSendBuffer._116_ "array gSendBuffer" UBYTE NO_COMPU_METHOD 0 0 0 255 READ_WRITE ECU_ADDRESS 0x70001158 FORMAT "%.15" PHYS_UNIT "km/h" /end MEASUREMENT
/begin MEASUREMENT gSendBuffer._117_ "array gSendBuffer" UBYTE NO_COMPU_METHOD 0 0 0 255 READ_WRITE ECU_ADDRESS 0x70001159 FORMAT "%.15" PHYS_UNIT "km/h" /end MEASUREMENT
/begin MEASUREMENT gSendBuffer._118_ "array gSendBuffer" UBYTE NO_COMPU_METHOD 0 0 0 255 READ_WRITE ECU_ADDRESS 0x7000115A FORMAT "%.15" PHYS_UNIT "km/h" /end MEASUREMENT
/begin MEASUREMENT gSendBuffer._119_ "array gSendBuffer" UBYTE NO_COMPU_METHOD 0 0 0 255 READ_WRITE ECU_ADDRESS 0x7000115B FORMAT "%.15" PHYS_UNIT "km/h" /end MEASUREMENT
/begin MEASUREMENT gSendBuffer._120_ "array gSendBuffer" UBYTE NO_COMPU_METHOD 0 0 0 255 READ_WRITE ECU_ADDRESS 0x7000115C FORMAT "%.15" PHYS_UNIT "km/h" /end MEASUREMENT
/begin MEASUREMENT gSendBuffer._121_ "array gSendBuffer" UBYTE NO_COMPU_METHOD 0 0 0 255 READ_WRITE ECU_ADDRESS 0x7000115D FORMAT "%.15" PHYS_UNIT "km/h" /end MEASUREMENT
/begin MEASUREMENT gSendBuffer._122_ "array gSendBuffer" UBYTE NO_COMPU_METHOD 0 0 0 255 READ_WRITE ECU_ADDRESS 0x7000115E FORMAT "%.15" PHYS_UNIT "km/h" /end MEASUREMENT
/begin MEASUREMENT gSendBuffer._123_ "array gSendBuffer" UBYTE NO_COMPU_METHOD 0 0 0 255 READ_WRITE ECU_ADDRESS 0x7000115F FORMAT "%.15" PHYS_UNIT "km/h" /end MEASUREMENT
/begin MEASUREMENT gSendBuffer._124_ "array gSendBuffer" UBYTE NO_COMPU_METHOD 0 0 0 255 READ_WRITE ECU_ADDRESS 0x70001160 FORMAT "%.15" PHYS_UNIT "km/h" /end MEASUREMENT
/begin MEASUREMENT gSendBuffer._125_ "array gSendBuffer" UBYTE NO_COMPU_METHOD 0 0 0 255 READ_WRITE ECU_ADDRESS 0x70001161 FORMAT "%.15" PHYS_UNIT "km/h" /end MEASUREMENT
/begin MEASUREMENT gSendBuffer._126_ "array gSendBuffer" UBYTE NO_COMPU_METHOD 0 0 0 255 READ_WRITE ECU_ADDRESS 0x70001162 FORMAT "%.15" PHYS_UNIT "km/h" /end MEASUREMENT
/begin MEASUREMENT gSendBuffer._127_ "array gSendBuffer" UBYTE NO_COMPU_METHOD 0 0 0 255 READ_WRITE ECU_ADDRESS 0x70001163 FORMAT "%.15" PHYS_UNIT "km/h" /end MEASUREMENT
/begin MEASUREMENT gSendBuffer._128_ "array gSendBuffer" UBYTE NO_COMPU_METHOD 0 0 0 255 READ_WRITE ECU_ADDRESS 0x70001164 FORMAT "%.15" PHYS_UNIT "km/h" /end MEASUREMENT
/begin MEASUREMENT gSendBuffer._129_ "array gSendBuffer" UBYTE NO_COMPU_METHOD 0 0 0 255 READ_WRITE ECU_ADDRESS 0x70001165 FORMAT "%.15" PHYS_UNIT "km/h" /end MEASUREMENT
/begin MEASUREMENT gSendBuffer._130_ "array gSendBuffer" UBYTE NO_COMPU_METHOD 0 0 0 255 READ_WRITE ECU_ADDRESS 0x70001166 FORMAT "%.15" PHYS_UNIT "km/h" /end MEASUREMENT
/begin MEASUREMENT gSendBuffer._131_ "array gSendBuffer" UBYTE NO_COMPU_METHOD 0 0 0 255 READ_WRITE ECU_ADDRESS 0x70001167 FORMAT "%.15" PHYS_UNIT "km/h" /end MEASUREMENT
/begin MEASUREMENT gSendBuffer._132_ "array gSendBuffer" UBYTE NO_COMPU_METHOD 0 0 0 255 READ_WRITE ECU_ADDRESS 0x70001168 FORMAT "%.15" PHYS_UNIT "km/h" /end MEASUREMENT
/begin MEASUREMENT gSendBuffer._133_ "array gSendBuffer" UBYTE NO_COMPU_METHOD 0 0 0 255 READ_WRITE ECU_ADDRESS 0x70001169 FORMAT "%.15" PHYS_UNIT "km/h" /end MEASUREMENT
/begin MEASUREMENT gSendBuffer._134_ "array gSendBuffer" UBYTE NO_COMPU_METHOD 0 0 0 255 READ_WRITE ECU_ADDRESS 0x7000116A FORMAT "%.15" PHYS_UNIT "km/h" /end MEASUREMENT
/begin MEASUREMENT gSendBuffer._135_ "array gSendBuffer" UBYTE NO_COMPU_METHOD 0 0 0 255 READ_WRITE ECU_ADDRESS 0x7000116B FORMAT "%.15" PHYS_UNIT "km/h" /end MEASUREMENT
/begin MEASUREMENT gSendBuffer._136_ "array gSendBuffer" UBYTE NO_COMPU_METHOD 0 0 0 255 READ_WRITE ECU_ADDRESS 0x7000116C FORMAT "%.15" PHYS_UNIT "km/h" /end MEASUREMENT
/begin MEASUREMENT gSendBuffer._137_ "array gSendBuffer" UBYTE NO_COMPU_METHOD 0 0 0 255 READ_WRITE ECU_ADDRESS 0x7000116D FORMAT "%.15" PHYS_UNIT "km/h" /end MEASUREMENT
/begin MEASUREMENT gSendBuffer._138_ "array gSendBuffer" UBYTE NO_COMPU_METHOD 0 0 0 255 READ_WRITE ECU_ADDRESS 0x7000116E FORMAT "%.15" PHYS_UNIT "km/h" /end MEASUREMENT
/begin MEASUREMENT gSendBuffer._139_ "array gSendBuffer" UBYTE NO_COMPU_METHOD 0 0 0 255 READ_WRITE ECU_ADDRESS 0x7000116F FORMAT "%.15" PHYS_UNIT "km/h" /end MEASUREMENT
/begin MEASUREMENT gSendBuffer._140_ "array gSendBuffer" UBYTE NO_COMPU_METHOD 0 0 0 255 READ_WRITE ECU_ADDRESS 0x70001170 FORMAT "%.15" PHYS_UNIT "km/h" /end MEASUREMENT
/begin MEASUREMENT gSendBuffer._141_ "array gSendBuffer" UBYTE NO_COMPU_METHOD 0 0 0 255 READ_WRITE ECU_ADDRESS 0x70001171 FORMAT "%.15" PHYS_UNIT "km/h" /end MEASUREMENT
/begin MEASUREMENT gSendBuffer._142_ "array gSendBuffer" UBYTE NO_COMPU_METHOD 0 0 0 255 READ_WRITE ECU_ADDRESS 0x70001172 FORMAT "%.15" PHYS_UNIT "km/h" /end MEASUREMENT
/begin MEASUREMENT gSendBuffer._143_ "array gSendBuffer" UBYTE NO_COMPU_METHOD 0 0 0 255 READ_WRITE ECU_ADDRESS 0x70001173 FORMAT "%.15" PHYS_UNIT "km/h" /end MEASUREMENT
/begin MEASUREMENT gSendBuffer._144_ "array gSendBuffer" UBYTE NO_COMPU_METHOD 0 0 0 255 READ_WRITE ECU_ADDRESS 0x70001174 FORMAT "%.15" PHYS_UNIT "km/h" /end MEASUREMENT
/begin MEASUREMENT gSendBuffer._145_ "array gSendBuffer" UBYTE NO_COMPU_METHOD 0 0 0 255 READ_WRITE ECU_ADDRESS 0x70001175 FORMAT "%.15" PHYS_UNIT "km/h" /end MEASUREMENT
/begin MEASUREMENT gSendBuffer._146_ "array gSendBuffer" UBYTE NO_COMPU_METHOD 0 0 0 255 READ_WRITE ECU_ADDRESS 0x70001176 FORMAT "%.15" PHYS_UNIT "km/h" /end MEASUREMENT
/begin MEASUREMENT gSendBuffer._147_ "array gSendBuffer" UBYTE NO_COMPU_METHOD 0 0 0 255 READ_WRITE ECU_ADDRESS 0x70001177 FORMAT "%.15" PHYS_UNIT "km/h" /end MEASUREMENT
/begin MEASUREMENT gSendBuffer._148_ "array gSendBuffer" UBYTE NO_COMPU_METHOD 0 0 0 255 READ_WRITE ECU_ADDRESS 0x70001178 FORMAT "%.15" PHYS_UNIT "km/h" /end MEASUREMENT
/begin MEASUREMENT gSendBuffer._149_ "array gSendBuffer" UBYTE NO_COMPU_METHOD 0 0 0 255 READ_WRITE ECU_ADDRESS 0x70001179 FORMAT "%.15" PHYS_UNIT "km/h" /end MEASUREMENT
/begin MEASUREMENT gSendBuffer._150_ "array gSendBuffer" UBYTE NO_COMPU_METHOD 0 0 0 255 READ_WRITE ECU_ADDRESS 0x7000117A FORMAT "%.15" PHYS_UNIT "km/h" /end MEASUREMENT
/begin MEASUREMENT gSendBuffer._151_ "array gSendBuffer" UBYTE NO_COMPU_METHOD 0 0 0 255 READ_WRITE ECU_ADDRESS 0x7000117B FORMAT "%.15" PHYS_UNIT "km/h" /end MEASUREMENT
/begin MEASUREMENT gSendBuffer._152_ "array gSendBuffer" UBYTE NO_COMPU_METHOD 0 0 0 255 READ_WRITE ECU_ADDRESS 0x7000117C FORMAT "%.15" PHYS_UNIT "km/h" /end MEASUREMENT
/begin MEASUREMENT gSendBuffer._153_ "array gSendBuffer" UBYTE NO_COMPU_METHOD 0 0 0 255 READ_WRITE ECU_ADDRESS 0x7000117D FORMAT "%.15" PHYS_UNIT "km/h" /end MEASUREMENT
/begin MEASUREMENT gSendBuffer._154_ "array gSendBuffer" UBYTE NO_COMPU_METHOD 0 0 0 255 READ_WRITE ECU_ADDRESS 0x7000117E FORMAT "%.15" PHYS_UNIT "km/h" /end MEASUREMENT
/begin MEASUREMENT gSendBuffer._155_ "array gSendBuffer" UBYTE NO_COMPU_METHOD 0 0 0 255 READ_WRITE ECU_ADDRESS 0x7000117F FORMAT "%.15" PHYS_UNIT "km/h" /end MEASUREMENT
/begin MEASUREMENT gSendBuffer._156_ "array gSendBuffer" UBYTE NO_COMPU_METHOD 0 0 0 255 READ_WRITE ECU_ADDRESS 0x70001180 FORMAT "%.15" PHYS_UNIT "km/h" /end MEASUREMENT
/begin MEASUREMENT gSendBuffer._157_ "array gSendBuffer" UBYTE NO_COMPU_METHOD 0 0 0 255 READ_WRITE ECU_ADDRESS 0x70001181 FORMAT "%.15" PHYS_UNIT "km/h" /end MEASUREMENT
/begin MEASUREMENT gSendBuffer._158_ "array gSendBuffer" UBYTE NO_COMPU_METHOD 0 0 0 255 READ_WRITE ECU_ADDRESS 0x70001182 FORMAT "%.15" PHYS_UNIT "km/h" /end MEASUREMENT
/begin MEASUREMENT gSendBuffer._159_ "array gSendBuffer" UBYTE NO_COMPU_METHOD 0 0 0 255 READ_WRITE ECU_ADDRESS 0x70001183 FORMAT "%.15" PHYS_UNIT "km/h" /end MEASUREMENT
/begin MEASUREMENT gSendBuffer._160_ "array gSendBuffer" UBYTE NO_COMPU_METHOD 0 0 0 255 READ_WRITE ECU_ADDRESS 0x70001184 FORMAT "%.15" PHYS_UNIT "km/h" /end MEASUREMENT
/begin MEASUREMENT gSendBuffer._161_ "array gSendBuffer" UBYTE NO_COMPU_METHOD 0 0 0 255 READ_WRITE ECU_ADDRESS 0x70001185 FORMAT "%.15" PHYS_UNIT "km/h" /end MEASUREMENT
/begin MEASUREMENT gSendBuffer._162_ "array gSendBuffer" UBYTE NO_COMPU_METHOD 0 0 0 255 READ_WRITE ECU_ADDRESS 0x70001186 FORMAT "%.15" PHYS_UNIT "km/h" /end MEASUREMENT
/begin MEASUREMENT gSendBuffer._163_ "array gSendBuffer" UBYTE NO_COMPU_METHOD 0 0 0 255 READ_WRITE ECU_ADDRESS 0x70001187 FORMAT "%.15" PHYS_UNIT "km/h" /end MEASUREMENT
/begin MEASUREMENT gSendBuffer._164_ "array gSendBuffer" UBYTE NO_COMPU_METHOD 0 0 0 255 READ_WRITE ECU_ADDRESS 0x70001188 FORMAT "%.15" PHYS_UNIT "km/h" /end MEASUREMENT
/begin MEASUREMENT gSendBuffer._165_ "array gSendBuffer" UBYTE NO_COMPU_METHOD 0 0 0 255 READ_WRITE ECU_ADDRESS 0x70001189 FORMAT "%.15" PHYS_UNIT "km/h" /end MEASUREMENT
/begin MEASUREMENT gSendBuffer._166_ "array gSendBuffer" UBYTE NO_COMPU_METHOD 0 0 0 255 READ_WRITE ECU_ADDRESS 0x7000118A FORMAT "%.15" PHYS_UNIT "km/h" /end MEASUREMENT
/begin MEASUREMENT gSendBuffer._167_ "array gSendBuffer" UBYTE NO_COMPU_METHOD 0 0 0 255 READ_WRITE ECU_ADDRESS 0x7000118B FORMAT "%.15" PHYS_UNIT "km/h" /end MEASUREMENT
/begin MEASUREMENT gSendBuffer._168_ "array gSendBuffer" UBYTE NO_COMPU_METHOD 0 0 0 255 READ_WRITE ECU_ADDRESS 0x7000118C FORMAT "%.15" PHYS_UNIT "km/h" /end MEASUREMENT
/begin MEASUREMENT gSendBuffer._169_ "array gSendBuffer" UBYTE NO_COMPU_METHOD 0 0 0 255 READ_WRITE ECU_ADDRESS 0x7000118D FORMAT "%.15" PHYS_UNIT "km/h" /end MEASUREMENT
/begin MEASUREMENT gSendBuffer._170_ "array gSendBuffer" UBYTE NO_COMPU_METHOD 0 0 0 255 READ_WRITE ECU_ADDRESS 0x7000118E FORMAT "%.15" PHYS_UNIT "km/h" /end MEASUREMENT
/begin MEASUREMENT gSendBuffer._171_ "array gSendBuffer" UBYTE NO_COMPU_METHOD 0 0 0 255 READ_WRITE ECU_ADDRESS 0x7000118F FORMAT "%.15" PHYS_UNIT "km/h" /end MEASUREMENT
/begin MEASUREMENT gSendBuffer._172_ "array gSendBuffer" UBYTE NO_COMPU_METHOD 0 0 0 255 READ_WRITE ECU_ADDRESS 0x70001190 FORMAT "%.15" PHYS_UNIT "km/h" /end MEASUREMENT
/begin MEASUREMENT gSendBuffer._173_ "array gSendBuffer" UBYTE NO_COMPU_METHOD 0 0 0 255 READ_WRITE ECU_ADDRESS 0x70001191 FORMAT "%.15" PHYS_UNIT "km/h" /end MEASUREMENT
/begin MEASUREMENT gSendBuffer._174_ "array gSendBuffer" UBYTE NO_COMPU_METHOD 0 0 0 255 READ_WRITE ECU_ADDRESS 0x70001192 FORMAT "%.15" PHYS_UNIT "km/h" /end MEASUREMENT
/begin MEASUREMENT gSendBuffer._175_ "array gSendBuffer" UBYTE NO_COMPU_METHOD 0 0 0 255 READ_WRITE ECU_ADDRESS 0x70001193 FORMAT "%.15" PHYS_UNIT "km/h" /end MEASUREMENT
/begin MEASUREMENT gSendBuffer._176_ "array gSendBuffer" UBYTE NO_COMPU_METHOD 0 0 0 255 READ_WRITE ECU_ADDRESS 0x70001194 FORMAT "%.15" PHYS_UNIT "km/h" /end MEASUREMENT
/begin MEASUREMENT gSendBuffer._177_ "array gSendBuffer" UBYTE NO_COMPU_METHOD 0 0 0 255 READ_WRITE ECU_ADDRESS 0x70001195 FORMAT "%.15" PHYS_UNIT "km/h" /end MEASUREMENT
/begin MEASUREMENT gSendBuffer._178_ "array gSendBuffer" UBYTE NO_COMPU_METHOD 0 0 0 255 READ_WRITE ECU_ADDRESS 0x70001196 FORMAT "%.15" PHYS_UNIT "km/h" /end MEASUREMENT
/begin MEASUREMENT gSendBuffer._179_ "array gSendBuffer" UBYTE NO_COMPU_METHOD 0 0 0 255 READ_WRITE ECU_ADDRESS 0x70001197 FORMAT "%.15" PHYS_UNIT "km/h" /end MEASUREMENT
/begin MEASUREMENT gSendBuffer._180_ "array gSendBuffer" UBYTE NO_COMPU_METHOD 0 0 0 255 READ_WRITE ECU_ADDRESS 0x70001198 FORMAT "%.15" PHYS_UNIT "km/h" /end MEASUREMENT
/begin MEASUREMENT gSendBuffer._181_ "array gSendBuffer" UBYTE NO_COMPU_METHOD 0 0 0 255 READ_WRITE ECU_ADDRESS 0x70001199 FORMAT "%.15" PHYS_UNIT "km/h" /end MEASUREMENT
/begin MEASUREMENT gSendBuffer._182_ "array gSendBuffer" UBYTE NO_COMPU_METHOD 0 0 0 255 READ_WRITE ECU_ADDRESS 0x7000119A FORMAT "%.15" PHYS_UNIT "km/h" /end MEASUREMENT
/begin MEASUREMENT gSendBuffer._183_ "array gSendBuffer" UBYTE NO_COMPU_METHOD 0 0 0 255 READ_WRITE ECU_ADDRESS 0x7000119B FORMAT "%.15" PHYS_UNIT "km/h" /end MEASUREMENT
/begin MEASUREMENT gSendBuffer._184_ "array gSendBuffer" UBYTE NO_COMPU_METHOD 0 0 0 255 READ_WRITE ECU_ADDRESS 0x7000119C FORMAT "%.15" PHYS_UNIT "km/h" /end MEASUREMENT
/begin MEASUREMENT gSendBuffer._185_ "array gSendBuffer" UBYTE NO_COMPU_METHOD 0 0 0 255 READ_WRITE ECU_ADDRESS 0x7000119D FORMAT "%.15" PHYS_UNIT "km/h" /end MEASUREMENT
/begin MEASUREMENT gSendBuffer._186_ "array gSendBuffer" UBYTE NO_COMPU_METHOD 0 0 0 255 READ_WRITE ECU_ADDRESS 0x7000119E FORMAT "%.15" PHYS_UNIT "km/h" /end MEASUREMENT
/begin MEASUREMENT gSendBuffer._187_ "array gSendBuffer" UBYTE NO_COMPU_METHOD 0 0 0 255 READ_WRITE ECU_ADDRESS 0x7000119F FORMAT "%.15" PHYS_UNIT "km/h" /end MEASUREMENT
/begin MEASUREMENT gSendBuffer._188_ "array gSendBuffer" UBYTE NO_COMPU_METHOD 0 0 0 255 READ_WRITE ECU_ADDRESS 0x700011A0 FORMAT "%.15" PHYS_UNIT "km/h" /end MEASUREMENT
/begin MEASUREMENT gSendBuffer._189_ "array gSendBuffer" UBYTE NO_COMPU_METHOD 0 0 0 255 READ_WRITE ECU_ADDRESS 0x700011A1 FORMAT "%.15" PHYS_UNIT "km/h" /end MEASUREMENT
/begin MEASUREMENT gSendBuffer._190_ "array gSendBuffer" UBYTE NO_COMPU_METHOD 0 0 0 255 READ_WRITE ECU_ADDRESS 0x700011A2 FORMAT "%.15" PHYS_UNIT "km/h" /end MEASUREMENT
/begin MEASUREMENT gSendBuffer._191_ "array gSendBuffer" UBYTE NO_COMPU_METHOD 0 0 0 255 READ_WRITE ECU_ADDRESS 0x700011A3 FORMAT "%.15" PHYS_UNIT "km/h" /end MEASUREMENT
/begin MEASUREMENT gSendBuffer._192_ "array gSendBuffer" UBYTE NO_COMPU_METHOD 0 0 0 255 READ_WRITE ECU_ADDRESS 0x700011A4 FORMAT "%.15" PHYS_UNIT "km/h" /end MEASUREMENT
/begin MEASUREMENT gSendBuffer._193_ "array gSendBuffer" UBYTE NO_COMPU_METHOD 0 0 0 255 READ_WRITE ECU_ADDRESS 0x700011A5 FORMAT "%.15" PHYS_UNIT "km/h" /end MEASUREMENT
/begin MEASUREMENT gSendBuffer._194_ "array gSendBuffer" UBYTE NO_COMPU_METHOD 0 0 0 255 READ_WRITE ECU_ADDRESS 0x700011A6 FORMAT "%.15" PHYS_UNIT "km/h" /end MEASUREMENT
/begin MEASUREMENT gSendBuffer._195_ "array gSendBuffer" UBYTE NO_COMPU_METHOD 0 0 0 255 READ_WRITE ECU_ADDRESS 0x700011A7 FORMAT "%.15" PHYS_UNIT "km/h" /end MEASUREMENT
/begin MEASUREMENT gSendBuffer._196_ "array gSendBuffer" UBYTE NO_COMPU_METHOD 0 0 0 255 READ_WRITE ECU_ADDRESS 0x700011A8 FORMAT "%.15" PHYS_UNIT "km/h" /end MEASUREMENT
/begin MEASUREMENT gSendBuffer._197_ "array gSendBuffer" UBYTE NO_COMPU_METHOD 0 0 0 255 READ_WRITE ECU_ADDRESS 0x700011A9 FORMAT "%.15" PHYS_UNIT "km/h" /end MEASUREMENT
/begin MEASUREMENT gSendBuffer._198_ "array gSendBuffer" UBYTE NO_COMPU_METHOD 0 0 0 255 READ_WRITE ECU_ADDRESS 0x700011AA FORMAT "%.15" PHYS_UNIT "km/h" /end MEASUREMENT
/begin MEASUREMENT gSendBuffer._199_ "array gSendBuffer" UBYTE NO_COMPU_METHOD 0 0 0 255 READ_WRITE ECU_ADDRESS 0x700011AB FORMAT "%.15" PHYS_UNIT "km/h" /end MEASUREMENT
/begin MEASUREMENT gSendBuffer._200_ "array gSendBuffer" UBYTE NO_COMPU_METHOD 0 0 0 255 READ_WRITE ECU_ADDRESS 0x700011AC FORMAT "%.15" PHYS_UNIT "km/h" /end MEASUREMENT
/begin MEASUREMENT gSendBuffer._201_ "array gSendBuffer" UBYTE NO_COMPU_METHOD 0 0 0 255 READ_WRITE ECU_ADDRESS 0x700011AD FORMAT "%.15" PHYS_UNIT "km/h" /end MEASUREMENT
/begin MEASUREMENT gSendBuffer._202_ "array gSendBuffer" UBYTE NO_COMPU_METHOD 0 0 0 255 READ_WRITE ECU_ADDRESS 0x700011AE FORMAT "%.15" PHYS_UNIT "km/h" /end MEASUREMENT
/begin MEASUREMENT gSendBuffer._203_ "array gSendBuffer" UBYTE NO_COMPU_METHOD 0 0 0 255 READ_WRITE ECU_ADDRESS 0x700011AF FORMAT "%.15" PHYS_UNIT "km/h" /end MEASUREMENT
/begin MEASUREMENT gSendBuffer._204_ "array gSendBuffer" UBYTE NO_COMPU_METHOD 0 0 0 255 READ_WRITE ECU_ADDRESS 0x700011B0 FORMAT "%.15" PHYS_UNIT "km/h" /end MEASUREMENT
/begin MEASUREMENT gSendBuffer._205_ "array gSendBuffer" UBYTE NO_COMPU_METHOD 0 0 0 255 READ_WRITE ECU_ADDRESS 0x700011B1 FORMAT "%.15" PHYS_UNIT "km/h" /end MEASUREMENT
/begin MEASUREMENT gSendBuffer._206_ "array gSendBuffer" UBYTE NO_COMPU_METHOD 0 0 0 255 READ_WRITE ECU_ADDRESS 0x700011B2 FORMAT "%.15" PHYS_UNIT "km/h" /end MEASUREMENT
/begin MEASUREMENT gSendBuffer._207_ "array gSendBuffer" UBYTE NO_COMPU_METHOD 0 0 0 255 READ_WRITE ECU_ADDRESS 0x700011B3 FORMAT "%.15" PHYS_UNIT "km/h" /end MEASUREMENT
/begin MEASUREMENT gSendBuffer._208_ "array gSendBuffer" UBYTE NO_COMPU_METHOD 0 0 0 255 READ_WRITE ECU_ADDRESS 0x700011B4 FORMAT "%.15" PHYS_UNIT "km/h" /end MEASUREMENT
/begin MEASUREMENT gSendBuffer._209_ "array gSendBuffer" UBYTE NO_COMPU_METHOD 0 0 0 255 READ_WRITE ECU_ADDRESS 0x700011B5 FORMAT "%.15" PHYS_UNIT "km/h" /end MEASUREMENT
/begin MEASUREMENT gSendBuffer._210_ "array gSendBuffer" UBYTE NO_COMPU_METHOD 0 0 0 255 READ_WRITE ECU_ADDRESS 0x700011B6 FORMAT "%.15" PHYS_UNIT "km/h" /end MEASUREMENT
/begin MEASUREMENT gSendBuffer._211_ "array gSendBuffer" UBYTE NO_COMPU_METHOD 0 0 0 255 READ_WRITE ECU_ADDRESS 0x700011B7 FORMAT "%.15" PHYS_UNIT "km/h" /end MEASUREMENT
/begin MEASUREMENT gSendBuffer._212_ "array gSendBuffer" UBYTE NO_COMPU_METHOD 0 0 0 255 READ_WRITE ECU_ADDRESS 0x700011B8 FORMAT "%.15" PHYS_UNIT "km/h" /end MEASUREMENT
/begin MEASUREMENT gSendBuffer._213_ "array gSendBuffer" UBYTE NO_COMPU_METHOD 0 0 0 255 READ_WRITE ECU_ADDRESS 0x700011B9 FORMAT "%.15" PHYS_UNIT "km/h" /end MEASUREMENT
/begin MEASUREMENT gSendBuffer._214_ "array gSendBuffer" UBYTE NO_COMPU_METHOD 0 0 0 255 READ_WRITE ECU_ADDRESS 0x700011BA FORMAT "%.15" PHYS_UNIT "km/h" /end MEASUREMENT
/begin MEASUREMENT gSendBuffer._215_ "array gSendBuffer" UBYTE NO_COMPU_METHOD 0 0 0 255 READ_WRITE ECU_ADDRESS 0x700011BB FORMAT "%.15" PHYS_UNIT "km/h" /end MEASUREMENT
/begin MEASUREMENT gSendBuffer._216_ "array gSendBuffer" UBYTE NO_COMPU_METHOD 0 0 0 255 READ_WRITE ECU_ADDRESS 0x700011BC FORMAT "%.15" PHYS_UNIT "km/h" /end MEASUREMENT
/begin MEASUREMENT gSendBuffer._217_ "array gSendBuffer" UBYTE NO_COMPU_METHOD 0 0 0 255 READ_WRITE ECU_ADDRESS 0x700011BD FORMAT "%.15" PHYS_UNIT "km/h" /end MEASUREMENT
/begin MEASUREMENT gSendBuffer._218_ "array gSendBuffer" UBYTE NO_COMPU_METHOD 0 0 0 255 READ_WRITE ECU_ADDRESS 0x700011BE FORMAT "%.15" PHYS_UNIT "km/h" /end MEASUREMENT
/begin MEASUREMENT gSendBuffer._219_ "array gSendBuffer" UBYTE NO_COMPU_METHOD 0 0 0 255 READ_WRITE ECU_ADDRESS 0x700011BF FORMAT "%.15" PHYS_UNIT "km/h" /end MEASUREMENT
/begin MEASUREMENT gSendBuffer._220_ "array gSendBuffer" UBYTE NO_COMPU_METHOD 0 0 0 255 READ_WRITE ECU_ADDRESS 0x700011C0 FORMAT "%.15" PHYS_UNIT "km/h" /end MEASUREMENT
/begin MEASUREMENT gSendBuffer._221_ "array gSendBuffer" UBYTE NO_COMPU_METHOD 0 0 0 255 READ_WRITE ECU_ADDRESS 0x700011C1 FORMAT "%.15" PHYS_UNIT "km/h" /end MEASUREMENT
/begin MEASUREMENT gSendBuffer._222_ "array gSendBuffer" UBYTE NO_COMPU_METHOD 0 0 0 255 READ_WRITE ECU_ADDRESS 0x700011C2 FORMAT "%.15" PHYS_UNIT "km/h" /end MEASUREMENT
/begin MEASUREMENT gSendBuffer._223_ "array gSendBuffer" UBYTE NO_COMPU_METHOD 0 0 0 255 READ_WRITE ECU_ADDRESS 0x700011C3 FORMAT "%.15" PHYS_UNIT "km/h" /end MEASUREMENT
/begin MEASUREMENT gSendBuffer._224_ "array gSendBuffer" UBYTE NO_COMPU_METHOD 0 0 0 255 READ_WRITE ECU_ADDRESS 0x700011C4 FORMAT "%.15" PHYS_UNIT "km/h" /end MEASUREMENT
/begin MEASUREMENT gSendBuffer._225_ "array gSendBuffer" UBYTE NO_COMPU_METHOD 0 0 0 255 READ_WRITE ECU_ADDRESS 0x700011C5 FORMAT "%.15" PHYS_UNIT "km/h" /end MEASUREMENT
/begin MEASUREMENT gSendBuffer._226_ "array gSendBuffer" UBYTE NO_COMPU_METHOD 0 0 0 255 READ_WRITE ECU_ADDRESS 0x700011C6 FORMAT "%.15" PHYS_UNIT "km/h" /end MEASUREMENT
/begin MEASUREMENT gSendBuffer._227_ "array gSendBuffer" UBYTE NO_COMPU_METHOD 0 0 0 255 READ_WRITE ECU_ADDRESS 0x700011C7 FORMAT "%.15" PHYS_UNIT "km/h" /end MEASUREMENT
/begin MEASUREMENT gSendBuffer._228_ "array gSendBuffer" UBYTE NO_COMPU_METHOD 0 0 0 255 READ_WRITE ECU_ADDRESS 0x700011C8 FORMAT "%.15" PHYS_UNIT "km/h" /end MEASUREMENT
/begin MEASUREMENT gSendBuffer._229_ "array gSendBuffer" UBYTE NO_COMPU_METHOD 0 0 0 255 READ_WRITE ECU_ADDRESS 0x700011C9 FORMAT "%.15" PHYS_UNIT "km/h" /end MEASUREMENT
/begin MEASUREMENT gSendBuffer._230_ "array gSendBuffer" UBYTE NO_COMPU_METHOD 0 0 0 255 READ_WRITE ECU_ADDRESS 0x700011CA FORMAT "%.15" PHYS_UNIT "km/h" /end MEASUREMENT
/begin MEASUREMENT gSendBuffer._231_ "array gSendBuffer" UBYTE NO_COMPU_METHOD 0 0 0 255 READ_WRITE ECU_ADDRESS 0x700011CB FORMAT "%.15" PHYS_UNIT "km/h" /end MEASUREMENT
/begin MEASUREMENT gSendBuffer._232_ "array gSendBuffer" UBYTE NO_COMPU_METHOD 0 0 0 255 READ_WRITE ECU_ADDRESS 0x700011CC FORMAT "%.15" PHYS_UNIT "km/h" /end MEASUREMENT
/begin MEASUREMENT gSendBuffer._233_ "array gSendBuffer" UBYTE NO_COMPU_METHOD 0 0 0 255 READ_WRITE ECU_ADDRESS 0x700011CD FORMAT "%.15" PHYS_UNIT "km/h" /end MEASUREMENT
/begin MEASUREMENT gSendBuffer._234_ "array gSendBuffer" UBYTE NO_COMPU_METHOD 0 0 0 255 READ_WRITE ECU_ADDRESS 0x700011CE FORMAT "%.15" PHYS_UNIT "km/h" /end MEASUREMENT
/begin MEASUREMENT gSendBuffer._235_ "array gSendBuffer" UBYTE NO_COMPU_METHOD 0 0 0 255 READ_WRITE ECU_ADDRESS 0x700011CF FORMAT "%.15" PHYS_UNIT "km/h" /end MEASUREMENT
/begin MEASUREMENT gSendBuffer._236_ "array gSendBuffer" UBYTE NO_COMPU_METHOD 0 0 0 255 READ_WRITE ECU_ADDRESS 0x700011D0 FORMAT "%.15" PHYS_UNIT "km/h" /end MEASUREMENT
/begin MEASUREMENT gSendBuffer._237_ "array gSendBuffer" UBYTE NO_COMPU_METHOD 0 0 0 255 READ_WRITE ECU_ADDRESS 0x700011D1 FORMAT "%.15" PHYS_UNIT "km/h" /end MEASUREMENT
/begin MEASUREMENT gSendBuffer._238_ "array gSendBuffer" UBYTE NO_COMPU_METHOD 0 0 0 255 READ_WRITE ECU_ADDRESS 0x700011D2 FORMAT "%.15" PHYS_UNIT "km/h" /end MEASUREMENT
/begin MEASUREMENT gSendBuffer._239_ "array gSendBuffer" UBYTE NO_COMPU_METHOD 0 0 0 255 READ_WRITE ECU_ADDRESS 0x700011D3 FORMAT "%.15" PHYS_UNIT "km/h" /end MEASUREMENT
/begin MEASUREMENT gSendBuffer._240_ "array gSendBuffer" UBYTE NO_COMPU_METHOD 0 0 0 255 READ_WRITE ECU_ADDRESS 0x700011D4 FORMAT "%.15" PHYS_UNIT "km/h" /end MEASUREMENT
/begin MEASUREMENT gSendBuffer._241_ "array gSendBuffer" UBYTE NO_COMPU_METHOD 0 0 0 255 READ_WRITE ECU_ADDRESS 0x700011D5 FORMAT "%.15" PHYS_UNIT "km/h" /end MEASUREMENT
/begin MEASUREMENT gSendBuffer._242_ "array gSendBuffer" UBYTE NO_COMPU_METHOD 0 0 0 255 READ_WRITE ECU_ADDRESS 0x700011D6 FORMAT "%.15" PHYS_UNIT "km/h" /end MEASUREMENT
/begin MEASUREMENT gSendBuffer._243_ "array gSendBuffer" UBYTE NO_COMPU_METHOD 0 0 0 255 READ_WRITE ECU_ADDRESS 0x700011D7 FORMAT "%.15" PHYS_UNIT "km/h" /end MEASUREMENT
/begin MEASUREMENT gSendBuffer._244_ "array gSendBuffer" UBYTE NO_COMPU_METHOD 0 0 0 255 READ_WRITE ECU_ADDRESS 0x700011D8 FORMAT "%.15" PHYS_UNIT "km/h" /end MEASUREMENT
/begin MEASUREMENT gSendBuffer._245_ "array gSendBuffer" UBYTE NO_COMPU_METHOD 0 0 0 255 READ_WRITE ECU_ADDRESS 0x700011D9 FORMAT "%.15" PHYS_UNIT "km/h" /end MEASUREMENT
/begin MEASUREMENT gSendBuffer._246_ "array gSendBuffer" UBYTE NO_COMPU_METHOD 0 0 0 255 READ_WRITE ECU_ADDRESS 0x700011DA FORMAT "%.15" PHYS_UNIT "km/h" /end MEASUREMENT
/begin MEASUREMENT gSendBuffer._247_ "array gSendBuffer" UBYTE NO_COMPU_METHOD 0 0 0 255 READ_WRITE ECU_ADDRESS 0x700011DB FORMAT "%.15" PHYS_UNIT "km/h" /end MEASUREMENT
/begin MEASUREMENT gSendBuffer._248_ "array gSendBuffer" UBYTE NO_COMPU_METHOD 0 0 0 255 READ_WRITE ECU_ADDRESS 0x700011DC FORMAT "%.15" PHYS_UNIT "km/h" /end MEASUREMENT
/begin MEASUREMENT gSendBuffer._249_ "array gSendBuffer" UBYTE NO_COMPU_METHOD 0 0 0 255 READ_WRITE ECU_ADDRESS 0x700011DD FORMAT "%.15" PHYS_UNIT "km/h" /end MEASUREMENT
/begin MEASUREMENT gSendBuffer._250_ "array gSendBuffer" UBYTE NO_COMPU_METHOD 0 0 0 255 READ_WRITE ECU_ADDRESS 0x700011DE FORMAT "%.15" PHYS_UNIT "km/h" /end MEASUREMENT
/begin MEASUREMENT gSendBuffer._251_ "array gSendBuffer" UBYTE NO_COMPU_METHOD 0 0 0 255 READ_WRITE ECU_ADDRESS 0x700011DF FORMAT "%.15" PHYS_UNIT "km/h" /end MEASUREMENT
/begin MEASUREMENT gSendBuffer._252_ "array gSendBuffer" UBYTE NO_COMPU_METHOD 0 0 0 255 READ_WRITE ECU_ADDRESS 0x700011E0 FORMAT "%.15" PHYS_UNIT "km/h" /end MEASUREMENT
/begin MEASUREMENT gSendBuffer._253_ "array gSendBuffer" UBYTE NO_COMPU_METHOD 0 0 0 255 READ_WRITE ECU_ADDRESS 0x700011E1 FORMAT "%.15" PHYS_UNIT "km/h" /end MEASUREMENT
/begin MEASUREMENT gSendBuffer._254_ "array gSendBuffer" UBYTE NO_COMPU_METHOD 0 0 0 255 READ_WRITE ECU_ADDRESS 0x700011E2 FORMAT "%.15" PHYS_UNIT "km/h" /end MEASUREMENT
/begin MEASUREMENT gSendBuffer._255_ "array gSendBuffer" UBYTE NO_COMPU_METHOD 0 0 0 255 READ_WRITE ECU_ADDRESS 0x700011E3 FORMAT "%.15" PHYS_UNIT "km/h" /end MEASUREMENT
/begin MEASUREMENT gSendBuffer._256_ "array gSendBuffer" UBYTE NO_COMPU_METHOD 0 0 0 255 READ_WRITE ECU_ADDRESS 0x700011E4 FORMAT "%.15" PHYS_UNIT "km/h" /end MEASUREMENT
/begin MEASUREMENT gSendBuffer._257_ "array gSendBuffer" UBYTE NO_COMPU_METHOD 0 0 0 255 READ_WRITE ECU_ADDRESS 0x700011E5 FORMAT "%.15" PHYS_UNIT "km/h" /end MEASUREMENT
/begin MEASUREMENT gSendBuffer._258_ "array gSendBuffer" UBYTE NO_COMPU_METHOD 0 0 0 255 READ_WRITE ECU_ADDRESS 0x700011E6 FORMAT "%.15" PHYS_UNIT "km/h" /end MEASUREMENT
/begin MEASUREMENT gSendBuffer._259_ "array gSendBuffer" UBYTE NO_COMPU_METHOD 0 0 0 255 READ_WRITE ECU_ADDRESS 0x700011E7 FORMAT "%.15" PHYS_UNIT "km/h" /end MEASUREMENT
/begin MEASUREMENT gSendBuffer._260_ "array gSendBuffer" UBYTE NO_COMPU_METHOD 0 0 0 255 READ_WRITE ECU_ADDRESS 0x700011E8 FORMAT "%.15" PHYS_UNIT "km/h" /end MEASUREMENT
/begin MEASUREMENT gSendBuffer._261_ "array gSendBuffer" UBYTE NO_COMPU_METHOD 0 0 0 255 READ_WRITE ECU_ADDRESS 0x700011E9 FORMAT "%.15" PHYS_UNIT "km/h" /end MEASUREMENT
/begin MEASUREMENT gSendBuffer._262_ "array gSendBuffer" UBYTE NO_COMPU_METHOD 0 0 0 255 READ_WRITE ECU_ADDRESS 0x700011EA FORMAT "%.15" PHYS_UNIT "km/h" /end MEASUREMENT
/begin MEASUREMENT gSendBuffer._263_ "array gSendBuffer" UBYTE NO_COMPU_METHOD 0 0 0 255 READ_WRITE ECU_ADDRESS 0x700011EB FORMAT "%.15" PHYS_UNIT "km/h" /end MEASUREMENT
/begin MEASUREMENT gSendBuffer._264_ "array gSendBuffer" UBYTE NO_COMPU_METHOD 0 0 0 255 READ_WRITE ECU_ADDRESS 0x700011EC FORMAT "%.15" PHYS_UNIT "km/h" /end MEASUREMENT
/begin MEASUREMENT gSendBuffer._265_ "array gSendBuffer" UBYTE NO_COMPU_METHOD 0 0 0 255 READ_WRITE ECU_ADDRESS 0x700011ED FORMAT "%.15" PHYS_UNIT "km/h" /end MEASUREMENT
/begin MEASUREMENT gSendBuffer._266_ "array gSendBuffer" UBYTE NO_COMPU_METHOD 0 0 0 255 READ_WRITE ECU_ADDRESS 0x700011EE FORMAT "%.15" PHYS_UNIT "km/h" /end MEASUREMENT
/begin MEASUREMENT gSendBuffer._267_ "array gSendBuffer" UBYTE NO_COMPU_METHOD 0 0 0 255 READ_WRITE ECU_ADDRESS 0x700011EF FORMAT "%.15" PHYS_UNIT "km/h" /end MEASUREMENT
/begin MEASUREMENT gSendBuffer._268_ "array gSendBuffer" UBYTE NO_COMPU_METHOD 0 0 0 255 READ_WRITE ECU_ADDRESS 0x700011F0 FORMAT "%.15" PHYS_UNIT "km/h" /end MEASUREMENT
/begin MEASUREMENT gSendBuffer._269_ "array gSendBuffer" UBYTE NO_COMPU_METHOD 0 0 0 255 READ_WRITE ECU_ADDRESS 0x700011F1 FORMAT "%.15" PHYS_UNIT "km/h" /end MEASUREMENT
/begin MEASUREMENT gSendBuffer._270_ "array gSendBuffer" UBYTE NO_COMPU_METHOD 0 0 0 255 READ_WRITE ECU_ADDRESS 0x700011F2 FORMAT "%.15" PHYS_UNIT "km/h" /end MEASUREMENT
/begin MEASUREMENT gSendBuffer._271_ "array gSendBuffer" UBYTE NO_COMPU_METHOD 0 0 0 255 READ_WRITE ECU_ADDRESS 0x700011F3 FORMAT "%.15" PHYS_UNIT "km/h" /end MEASUREMENT
/begin MEASUREMENT gSendBuffer._272_ "array gSendBuffer" UBYTE NO_COMPU_METHOD 0 0 0 255 READ_WRITE ECU_ADDRESS 0x700011F4 FORMAT "%.15" PHYS_UNIT "km/h" /end MEASUREMENT
/begin MEASUREMENT gSendBuffer._273_ "array gSendBuffer" UBYTE NO_COMPU_METHOD 0 0 0 255 READ_WRITE ECU_ADDRESS 0x700011F5 FORMAT "%.15" PHYS_UNIT "km/h" /end MEASUREMENT
/begin MEASUREMENT gSendBuffer._274_ "array gSendBuffer" UBYTE NO_COMPU_METHOD 0 0 0 255 READ_WRITE ECU_ADDRESS 0x700011F6 FORMAT "%.15" PHYS_UNIT "km/h" /end MEASUREMENT
/begin MEASUREMENT gSendBuffer._275_ "array gSendBuffer" UBYTE NO_COMPU_METHOD 0 0 0 255 READ_WRITE ECU_ADDRESS 0x700011F7 FORMAT "%.15" PHYS_UNIT "km/h" /end MEASUREMENT
/begin MEASUREMENT gSendBuffer._276_ "array gSendBuffer" UBYTE NO_COMPU_METHOD 0 0 0 255 READ_WRITE ECU_ADDRESS 0x700011F8 FORMAT "%.15" PHYS_UNIT "km/h" /end MEASUREMENT
/begin MEASUREMENT gSendBuffer._277_ "array gSendBuffer" UBYTE NO_COMPU_METHOD 0 0 0 255 READ_WRITE ECU_ADDRESS 0x700011F9 FORMAT "%.15" PHYS_UNIT "km/h" /end MEASUREMENT
/begin MEASUREMENT gSendBuffer._278_ "array gSendBuffer" UBYTE NO_COMPU_METHOD 0 0 0 255 READ_WRITE ECU_ADDRESS 0x700011FA FORMAT "%.15" PHYS_UNIT "km/h" /end MEASUREMENT
/begin MEASUREMENT gSendBuffer._279_ "array gSendBuffer" UBYTE NO_COMPU_METHOD 0 0 0 255 READ_WRITE ECU_ADDRESS 0x700011FB FORMAT "%.15" PHYS_UNIT "km/h" /end MEASUREMENT
/begin MEASUREMENT gSendBuffer._280_ "array gSendBuffer" UBYTE NO_COMPU_METHOD 0 0 0 255 READ_WRITE ECU_ADDRESS 0x700011FC FORMAT "%.15" PHYS_UNIT "km/h" /end MEASUREMENT
/begin MEASUREMENT gSendBuffer._281_ "array gSendBuffer" UBYTE NO_COMPU_METHOD 0 0 0 255 READ_WRITE ECU_ADDRESS 0x700011FD FORMAT "%.15" PHYS_UNIT "km/h" /end MEASUREMENT
/begin MEASUREMENT gSendBuffer._282_ "array gSendBuffer" UBYTE NO_COMPU_METHOD 0 0 0 255 READ_WRITE ECU_ADDRESS 0x700011FE FORMAT "%.15" PHYS_UNIT "km/h" /end MEASUREMENT
/begin MEASUREMENT gSendBuffer._283_ "array gSendBuffer" UBYTE NO_COMPU_METHOD 0 0 0 255 READ_WRITE ECU_ADDRESS 0x700011FF FORMAT "%.15" PHYS_UNIT "km/h" /end MEASUREMENT
/begin MEASUREMENT gSendBuffer._284_ "array gSendBuffer" UBYTE NO_COMPU_METHOD 0 0 0 255 READ_WRITE ECU_ADDRESS 0x70001200 FORMAT "%.15" PHYS_UNIT "km/h" /end MEASUREMENT
/begin MEASUREMENT gSendBuffer._285_ "array gSendBuffer" UBYTE NO_COMPU_METHOD 0 0 0 255 READ_WRITE ECU_ADDRESS 0x70001201 FORMAT "%.15" PHYS_UNIT "km/h" /end MEASUREMENT
/begin MEASUREMENT gSendBuffer._286_ "array gSendBuffer" UBYTE NO_COMPU_METHOD 0 0 0 255 READ_WRITE ECU_ADDRESS 0x70001202 FORMAT "%.15" PHYS_UNIT "km/h" /end MEASUREMENT
/begin MEASUREMENT gSendBuffer._287_ "array gSendBuffer" UBYTE NO_COMPU_METHOD 0 0 0 255 READ_WRITE ECU_ADDRESS 0x70001203 FORMAT "%.15" PHYS_UNIT "km/h" /end MEASUREMENT
/begin MEASUREMENT gSendBuffer._288_ "array gSendBuffer" UBYTE NO_COMPU_METHOD 0 0 0 255 READ_WRITE ECU_ADDRESS 0x70001204 FORMAT "%.15" PHYS_UNIT "km/h" /end MEASUREMENT
/begin MEASUREMENT gSendBuffer._289_ "array gSendBuffer" UBYTE NO_COMPU_METHOD 0 0 0 255 READ_WRITE ECU_ADDRESS 0x70001205 FORMAT "%.15" PHYS_UNIT "km/h" /end MEASUREMENT
/begin MEASUREMENT gSendBuffer._290_ "array gSendBuffer" UBYTE NO_COMPU_METHOD 0 0 0 255 READ_WRITE ECU_ADDRESS 0x70001206 FORMAT "%.15" PHYS_UNIT "km/h" /end MEASUREMENT
/begin MEASUREMENT gSendBuffer._291_ "array gSendBuffer" UBYTE NO_COMPU_METHOD 0 0 0 255 READ_WRITE ECU_ADDRESS 0x70001207 FORMAT "%.15" PHYS_UNIT "km/h" /end MEASUREMENT
/begin MEASUREMENT gSendBuffer._292_ "array gSendBuffer" UBYTE NO_COMPU_METHOD 0 0 0 255 READ_WRITE ECU_ADDRESS 0x70001208 FORMAT "%.15" PHYS_UNIT "km/h" /end MEASUREMENT
/begin MEASUREMENT gSendBuffer._293_ "array gSendBuffer" UBYTE NO_COMPU_METHOD 0 0 0 255 READ_WRITE ECU_ADDRESS 0x70001209 FORMAT "%.15" PHYS_UNIT "km/h" /end MEASUREMENT
/begin MEASUREMENT gSendBuffer._294_ "array gSendBuffer" UBYTE NO_COMPU_METHOD 0 0 0 255 READ_WRITE ECU_ADDRESS 0x7000120A FORMAT "%.15" PHYS_UNIT "km/h" /end MEASUREMENT
/begin MEASUREMENT gSendBuffer._295_ "array gSendBuffer" UBYTE NO_COMPU_METHOD 0 0 0 255 READ_WRITE ECU_ADDRESS 0x7000120B FORMAT "%.15" PHYS_UNIT "km/h" /end MEASUREMENT
/begin MEASUREMENT gSendBuffer._296_ "array gSendBuffer" UBYTE NO_COMPU_METHOD 0 0 0 255 READ_WRITE ECU_ADDRESS 0x7000120C FORMAT "%.15" PHYS_UNIT "km/h" /end MEASUREMENT
/begin MEASUREMENT gSendBuffer._297_ "array gSendBuffer" UBYTE NO_COMPU_METHOD 0 0 0 255 READ_WRITE ECU_ADDRESS 0x7000120D FORMAT "%.15" PHYS_UNIT "km/h" /end MEASUREMENT
/begin MEASUREMENT gSendBuffer._298_ "array gSendBuffer" UBYTE NO_COMPU_METHOD 0 0 0 255 READ_WRITE ECU_ADDRESS 0x7000120E FORMAT "%.15" PHYS_UNIT "km/h" /end MEASUREMENT
/begin MEASUREMENT gSendBuffer._299_ "array gSendBuffer" UBYTE NO_COMPU_METHOD 0 0 0 255 READ_WRITE ECU_ADDRESS 0x7000120F FORMAT "%.15" PHYS_UNIT "km/h" /end MEASUREMENT
/begin MEASUREMENT gSendBuffer._300_ "array gSendBuffer" UBYTE NO_COMPU_METHOD 0 0 0 255 READ_WRITE ECU_ADDRESS 0x70001210 FORMAT "%.15" PHYS_UNIT "km/h" /end MEASUREMENT
/begin MEASUREMENT gSendBuffer._301_ "array gSendBuffer" UBYTE NO_COMPU_METHOD 0 0 0 255 READ_WRITE ECU_ADDRESS 0x70001211 FORMAT "%.15" PHYS_UNIT "km/h" /end MEASUREMENT
/begin MEASUREMENT gSendBuffer._302_ "array gSendBuffer" UBYTE NO_COMPU_METHOD 0 0 0 255 READ_WRITE ECU_ADDRESS 0x70001212 FORMAT "%.15" PHYS_UNIT "km/h" /end MEASUREMENT
/begin MEASUREMENT gSendBuffer._303_ "array gSendBuffer" UBYTE NO_COMPU_METHOD 0 0 0 255 READ_WRITE ECU_ADDRESS 0x70001213 FORMAT "%.15" PHYS_UNIT "km/h" /end MEASUREMENT
/begin MEASUREMENT gSendBuffer._304_ "array gSendBuffer" UBYTE NO_COMPU_METHOD 0 0 0 255 READ_WRITE ECU_ADDRESS 0x70001214 FORMAT "%.15" PHYS_UNIT "km/h" /end MEASUREMENT
/begin MEASUREMENT gSendBuffer._305_ "array gSendBuffer" UBYTE NO_COMPU_METHOD 0 0 0 255 READ_WRITE ECU_ADDRESS 0x70001215 FORMAT "%.15" PHYS_UNIT "km/h" /end MEASUREMENT
/begin MEASUREMENT gSendBuffer._306_ "array gSendBuffer" UBYTE NO_COMPU_METHOD 0 0 0 255 READ_WRITE ECU_ADDRESS 0x70001216 FORMAT "%.15" PHYS_UNIT "km/h" /end MEASUREMENT
/begin MEASUREMENT gSendBuffer._307_ "array gSendBuffer" UBYTE NO_COMPU_METHOD 0 0 0 255 READ_WRITE ECU_ADDRESS 0x70001217 FORMAT "%.15" PHYS_UNIT "km/h" /end MEASUREMENT
/begin MEASUREMENT gSendBuffer._308_ "array gSendBuffer" UBYTE NO_COMPU_METHOD 0 0 0 255 READ_WRITE ECU_ADDRESS 0x70001218 FORMAT "%.15" PHYS_UNIT "km/h" /end MEASUREMENT
/begin MEASUREMENT gSendBuffer._309_ "array gSendBuffer" UBYTE NO_COMPU_METHOD 0 0 0 255 READ_WRITE ECU_ADDRESS 0x70001219 FORMAT "%.15" PHYS_UNIT "km/h" /end MEASUREMENT
/begin MEASUREMENT gSendBuffer._310_ "array gSendBuffer" UBYTE NO_COMPU_METHOD 0 0 0 255 READ_WRITE ECU_ADDRESS 0x7000121A FORMAT "%.15" PHYS_UNIT "km/h" /end MEASUREMENT
/begin MEASUREMENT gSendBuffer._311_ "array gSendBuffer" UBYTE NO_COMPU_METHOD 0 0 0 255 READ_WRITE ECU_ADDRESS 0x7000121B FORMAT "%.15" PHYS_UNIT "km/h" /end MEASUREMENT
/begin MEASUREMENT gSendBuffer._312_ "array gSendBuffer" UBYTE NO_COMPU_METHOD 0 0 0 255 READ_WRITE ECU_ADDRESS 0x7000121C FORMAT "%.15" PHYS_UNIT "km/h" /end MEASUREMENT
/begin MEASUREMENT gSendBuffer._313_ "array gSendBuffer" UBYTE NO_COMPU_METHOD 0 0 0 255 READ_WRITE ECU_ADDRESS 0x7000121D FORMAT "%.15" PHYS_UNIT "km/h" /end MEASUREMENT
/begin MEASUREMENT gSendBuffer._314_ "array gSendBuffer" UBYTE NO_COMPU_METHOD 0 0 0 255 READ_WRITE ECU_ADDRESS 0x7000121E FORMAT "%.15" PHYS_UNIT "km/h" /end MEASUREMENT
/begin MEASUREMENT gSendBuffer._315_ "array gSendBuffer" UBYTE NO_COMPU_METHOD 0 0 0 255 READ_WRITE ECU_ADDRESS 0x7000121F FORMAT "%.15" PHYS_UNIT "km/h" /end MEASUREMENT
/begin MEASUREMENT gSendBuffer._316_ "array gSendBuffer" UBYTE NO_COMPU_METHOD 0 0 0 255 READ_WRITE ECU_ADDRESS 0x70001220 FORMAT "%.15" PHYS_UNIT "km/h" /end MEASUREMENT
/begin MEASUREMENT gSendBuffer._317_ "array gSendBuffer" UBYTE NO_COMPU_METHOD 0 0 0 255 READ_WRITE ECU_ADDRESS 0x70001221 FORMAT "%.15" PHYS_UNIT "km/h" /end MEASUREMENT
/begin MEASUREMENT gSendBuffer._318_ "array gSendBuffer" UBYTE NO_COMPU_METHOD 0 0 0 255 READ_WRITE ECU_ADDRESS 0x70001222 FORMAT "%.15" PHYS_UNIT "km/h" /end MEASUREMENT
/begin MEASUREMENT gSendBuffer._319_ "array gSendBuffer" UBYTE NO_COMPU_METHOD 0 0 0 255 READ_WRITE ECU_ADDRESS 0x70001223 FORMAT "%.15" PHYS_UNIT "km/h" /end MEASUREMENT
/begin MEASUREMENT gSendBuffer._320_ "array gSendBuffer" UBYTE NO_COMPU_METHOD 0 0 0 255 READ_WRITE ECU_ADDRESS 0x70001224 FORMAT "%.15" PHYS_UNIT "km/h" /end MEASUREMENT
/begin MEASUREMENT gSendBuffer._321_ "array gSendBuffer" UBYTE NO_COMPU_METHOD 0 0 0 255 READ_WRITE ECU_ADDRESS 0x70001225 FORMAT "%.15" PHYS_UNIT "km/h" /end MEASUREMENT
/begin MEASUREMENT gSendBuffer._322_ "array gSendBuffer" UBYTE NO_COMPU_METHOD 0 0 0 255 READ_WRITE ECU_ADDRESS 0x70001226 FORMAT "%.15" PHYS_UNIT "km/h" /end MEASUREMENT
/begin MEASUREMENT gSendBuffer._323_ "array gSendBuffer" UBYTE NO_COMPU_METHOD 0 0 0 255 READ_WRITE ECU_ADDRESS 0x70001227 FORMAT "%.15" PHYS_UNIT "km/h" /end MEASUREMENT
/begin MEASUREMENT gSendBuffer._324_ "array gSendBuffer" UBYTE NO_COMPU_METHOD 0 0 0 255 READ_WRITE ECU_ADDRESS 0x70001228 FORMAT "%.15" PHYS_UNIT "km/h" /end MEASUREMENT
/begin MEASUREMENT gSendBuffer._325_ "array gSendBuffer" UBYTE NO_COMPU_METHOD 0 0 0 255 READ_WRITE ECU_ADDRESS 0x70001229 FORMAT "%.15" PHYS_UNIT "km/h" /end MEASUREMENT
/begin MEASUREMENT gSendBuffer._326_ "array gSendBuffer" UBYTE NO_COMPU_METHOD 0 0 0 255 READ_WRITE ECU_ADDRESS 0x7000122A FORMAT "%.15" PHYS_UNIT "km/h" /end MEASUREMENT
/begin MEASUREMENT gSendBuffer._327_ "array gSendBuffer" UBYTE NO_COMPU_METHOD 0 0 0 255 READ_WRITE ECU_ADDRESS 0x7000122B FORMAT "%.15" PHYS_UNIT "km/h" /end MEASUREMENT
/begin MEASUREMENT gSendBuffer._328_ "array gSendBuffer" UBYTE NO_COMPU_METHOD 0 0 0 255 READ_WRITE ECU_ADDRESS 0x7000122C FORMAT "%.15" PHYS_UNIT "km/h" /end MEASUREMENT
/begin MEASUREMENT gSendBuffer._329_ "array gSendBuffer" UBYTE NO_COMPU_METHOD 0 0 0 255 READ_WRITE ECU_ADDRESS 0x7000122D FORMAT "%.15" PHYS_UNIT "km/h" /end MEASUREMENT
/begin MEASUREMENT gSendBuffer._330_ "array gSendBuffer" UBYTE NO_COMPU_METHOD 0 0 0 255 READ_WRITE ECU_ADDRESS 0x7000122E FORMAT "%.15" PHYS_UNIT "km/h" /end MEASUREMENT
/begin MEASUREMENT gSendBuffer._331_ "array gSendBuffer" UBYTE NO_COMPU_METHOD 0 0 0 255 READ_WRITE ECU_ADDRESS 0x7000122F FORMAT "%.15" PHYS_UNIT "km/h" /end MEASUREMENT
/begin MEASUREMENT gSendBuffer._332_ "array gSendBuffer" UBYTE NO_COMPU_METHOD 0 0 0 255 READ_WRITE ECU_ADDRESS 0x70001230 FORMAT "%.15" PHYS_UNIT "km/h" /end MEASUREMENT
/begin MEASUREMENT gSendBuffer._333_ "array gSendBuffer" UBYTE NO_COMPU_METHOD 0 0 0 255 READ_WRITE ECU_ADDRESS 0x70001231 FORMAT "%.15" PHYS_UNIT "km/h" /end MEASUREMENT
/begin MEASUREMENT gSendBuffer._334_ "array gSendBuffer" UBYTE NO_COMPU_METHOD 0 0 0 255 READ_WRITE ECU_ADDRESS 0x70001232 FORMAT "%.15" PHYS_UNIT "km/h" /end MEASUREMENT
/begin MEASUREMENT gSendBuffer._335_ "array gSendBuffer" UBYTE NO_COMPU_METHOD 0 0 0 255 READ_WRITE ECU_ADDRESS 0x70001233 FORMAT "%.15" PHYS_UNIT "km/h" /end MEASUREMENT
/begin MEASUREMENT gSendBuffer._336_ "array gSendBuffer" UBYTE NO_COMPU_METHOD 0 0 0 255 READ_WRITE ECU_ADDRESS 0x70001234 FORMAT "%.15" PHYS_UNIT "km/h" /end MEASUREMENT
/begin MEASUREMENT gSendBuffer._337_ "array gSendBuffer" UBYTE NO_COMPU_METHOD 0 0 0 255 READ_WRITE ECU_ADDRESS 0x70001235 FORMAT "%.15" PHYS_UNIT "km/h" /end MEASUREMENT
/begin MEASUREMENT gSendBuffer._338_ "array gSendBuffer" UBYTE NO_COMPU_METHOD 0 0 0 255 READ_WRITE ECU_ADDRESS 0x70001236 FORMAT "%.15" PHYS_UNIT "km/h" /end MEASUREMENT
/begin MEASUREMENT gSendBuffer._339_ "array gSendBuffer" UBYTE NO_COMPU_METHOD 0 0 0 255 READ_WRITE ECU_ADDRESS 0x70001237 FORMAT "%.15" PHYS_UNIT "km/h" /end MEASUREMENT
/begin MEASUREMENT gSendBuffer._340_ "array gSendBuffer" UBYTE NO_COMPU_METHOD 0 0 0 255 READ_WRITE ECU_ADDRESS 0x70001238 FORMAT "%.15" PHYS_UNIT "km/h" /end MEASUREMENT
/begin MEASUREMENT gSendBuffer._341_ "array gSendBuffer" UBYTE NO_COMPU_METHOD 0 0 0 255 READ_WRITE ECU_ADDRESS 0x70001239 FORMAT "%.15" PHYS_UNIT "km/h" /end MEASUREMENT
/begin MEASUREMENT gSendBuffer._342_ "array gSendBuffer" UBYTE NO_COMPU_METHOD 0 0 0 255 READ_WRITE ECU_ADDRESS 0x7000123A FORMAT "%.15" PHYS_UNIT "km/h" /end MEASUREMENT
/begin MEASUREMENT gSendBuffer._343_ "array gSendBuffer" UBYTE NO_COMPU_METHOD 0 0 0 255 READ_WRITE ECU_ADDRESS 0x7000123B FORMAT "%.15" PHYS_UNIT "km/h" /end MEASUREMENT
/begin MEASUREMENT gSendBuffer._344_ "array gSendBuffer" UBYTE NO_COMPU_METHOD 0 0 0 255 READ_WRITE ECU_ADDRESS 0x7000123C FORMAT "%.15" PHYS_UNIT "km/h" /end MEASUREMENT
/begin MEASUREMENT gSendBuffer._345_ "array gSendBuffer" UBYTE NO_COMPU_METHOD 0 0 0 255 READ_WRITE ECU_ADDRESS 0x7000123D FORMAT "%.15" PHYS_UNIT "km/h" /end MEASUREMENT
/begin MEASUREMENT gSendBuffer._346_ "array gSendBuffer" UBYTE NO_COMPU_METHOD 0 0 0 255 READ_WRITE ECU_ADDRESS 0x7000123E FORMAT "%.15" PHYS_UNIT "km/h" /end MEASUREMENT
/begin MEASUREMENT gSendBuffer._347_ "array gSendBuffer" UBYTE NO_COMPU_METHOD 0 0 0 255 READ_WRITE ECU_ADDRESS 0x7000123F FORMAT "%.15" PHYS_UNIT "km/h" /end MEASUREMENT
/begin MEASUREMENT gSendBuffer._348_ "array gSendBuffer" UBYTE NO_COMPU_METHOD 0 0 0 255 READ_WRITE ECU_ADDRESS 0x70001240 FORMAT "%.15" PHYS_UNIT "km/h" /end MEASUREMENT
/begin MEASUREMENT gSendBuffer._349_ "array gSendBuffer" UBYTE NO_COMPU_METHOD 0 0 0 255 READ_WRITE ECU_ADDRESS 0x70001241 FORMAT "%.15" PHYS_UNIT "km/h" /end MEASUREMENT
/begin MEASUREMENT gSendBuffer._350_ "array gSendBuffer" UBYTE NO_COMPU_METHOD 0 0 0 255 READ_WRITE ECU_ADDRESS 0x70001242 FORMAT "%.15" PHYS_UNIT "km/h" /end MEASUREMENT
/begin MEASUREMENT gSendBuffer._351_ "array gSendBuffer" UBYTE NO_COMPU_METHOD 0 0 0 255 READ_WRITE ECU_ADDRESS 0x70001243 FORMAT "%.15" PHYS_UNIT "km/h" /end MEASUREMENT
/begin MEASUREMENT gSendBuffer._352_ "array gSendBuffer" UBYTE NO_COMPU_METHOD 0 0 0 255 READ_WRITE ECU_ADDRESS 0x70001244 FORMAT "%.15" PHYS_UNIT "km/h" /end MEASUREMENT
/begin MEASUREMENT gSendBuffer._353_ "array gSendBuffer" UBYTE NO_COMPU_METHOD 0 0 0 255 READ_WRITE ECU_ADDRESS 0x70001245 FORMAT "%.15" PHYS_UNIT "km/h" /end MEASUREMENT
/begin MEASUREMENT gSendBuffer._354_ "array gSendBuffer" UBYTE NO_COMPU_METHOD 0 0 0 255 READ_WRITE ECU_ADDRESS 0x70001246 FORMAT "%.15" PHYS_UNIT "km/h" /end MEASUREMENT
/begin MEASUREMENT gSendBuffer._355_ "array gSendBuffer" UBYTE NO_COMPU_METHOD 0 0 0 255 READ_WRITE ECU_ADDRESS 0x70001247 FORMAT "%.15" PHYS_UNIT "km/h" /end MEASUREMENT
/begin MEASUREMENT gSendBuffer._356_ "array gSendBuffer" UBYTE NO_COMPU_METHOD 0 0 0 255 READ_WRITE ECU_ADDRESS 0x70001248 FORMAT "%.15" PHYS_UNIT "km/h" /end MEASUREMENT
/begin MEASUREMENT gSendBuffer._357_ "array gSendBuffer" UBYTE NO_COMPU_METHOD 0 0 0 255 READ_WRITE ECU_ADDRESS 0x70001249 FORMAT "%.15" PHYS_UNIT "km/h" /end MEASUREMENT
/begin MEASUREMENT gSendBuffer._358_ "array gSendBuffer" UBYTE NO_COMPU_METHOD 0 0 0 255 READ_WRITE ECU_ADDRESS 0x7000124A FORMAT "%.15" PHYS_UNIT "km/h" /end MEASUREMENT
/begin MEASUREMENT gSendBuffer._359_ "array gSendBuffer" UBYTE NO_COMPU_METHOD 0 0 0 255 READ_WRITE ECU_ADDRESS 0x7000124B FORMAT "%.15" PHYS_UNIT "km/h" /end MEASUREMENT
/begin MEASUREMENT gSendBuffer._360_ "array gSendBuffer" UBYTE NO_COMPU_METHOD 0 0 0 255 READ_WRITE ECU_ADDRESS 0x7000124C FORMAT "%.15" PHYS_UNIT "km/h" /end MEASUREMENT
/begin MEASUREMENT gSendBuffer._361_ "array gSendBuffer" UBYTE NO_COMPU_METHOD 0 0 0 255 READ_WRITE ECU_ADDRESS 0x7000124D FORMAT "%.15" PHYS_UNIT "km/h" /end MEASUREMENT
/begin MEASUREMENT gSendBuffer._362_ "array gSendBuffer" UBYTE NO_COMPU_METHOD 0 0 0 255 READ_WRITE ECU_ADDRESS 0x7000124E FORMAT "%.15" PHYS_UNIT "km/h" /end MEASUREMENT
/begin MEASUREMENT gSendBuffer._363_ "array gSendBuffer" UBYTE NO_COMPU_METHOD 0 0 0 255 READ_WRITE ECU_ADDRESS 0x7000124F FORMAT "%.15" PHYS_UNIT "km/h" /end MEASUREMENT
/begin MEASUREMENT gSendBuffer._364_ "array gSendBuffer" UBYTE NO_COMPU_METHOD 0 0 0 255 READ_WRITE ECU_ADDRESS 0x70001250 FORMAT "%.15" PHYS_UNIT "km/h" /end MEASUREMENT
/begin MEASUREMENT gSendBuffer._365_ "array gSendBuffer" UBYTE NO_COMPU_METHOD 0 0 0 255 READ_WRITE ECU_ADDRESS 0x70001251 FORMAT "%.15" PHYS_UNIT "km/h" /end MEASUREMENT
/begin MEASUREMENT gSendBuffer._366_ "array gSendBuffer" UBYTE NO_COMPU_METHOD 0 0 0 255 READ_WRITE ECU_ADDRESS 0x70001252 FORMAT "%.15" PHYS_UNIT "km/h" /end MEASUREMENT
/begin MEASUREMENT gSendBuffer._367_ "array gSendBuffer" UBYTE NO_COMPU_METHOD 0 0 0 255 READ_WRITE ECU_ADDRESS 0x70001253 FORMAT "%.15" PHYS_UNIT "km/h" /end MEASUREMENT
/begin MEASUREMENT gSendBuffer._368_ "array gSendBuffer" UBYTE NO_COMPU_METHOD 0 0 0 255 READ_WRITE ECU_ADDRESS 0x70001254 FORMAT "%.15" PHYS_UNIT "km/h" /end MEASUREMENT
/begin MEASUREMENT gSendBuffer._369_ "array gSendBuffer" UBYTE NO_COMPU_METHOD 0 0 0 255 READ_WRITE ECU_ADDRESS 0x70001255 FORMAT "%.15" PHYS_UNIT "km/h" /end MEASUREMENT
/begin MEASUREMENT gSendBuffer._370_ "array gSendBuffer" UBYTE NO_COMPU_METHOD 0 0 0 255 READ_WRITE ECU_ADDRESS 0x70001256 FORMAT "%.15" PHYS_UNIT "km/h" /end MEASUREMENT
/begin MEASUREMENT gSendBuffer._371_ "array gSendBuffer" UBYTE NO_COMPU_METHOD 0 0 0 255 READ_WRITE ECU_ADDRESS 0x70001257 FORMAT "%.15" PHYS_UNIT "km/h" /end MEASUREMENT
/begin MEASUREMENT gSendBuffer._372_ "array gSendBuffer" UBYTE NO_COMPU_METHOD 0 0 0 255 READ_WRITE ECU_ADDRESS 0x70001258 FORMAT "%.15" PHYS_UNIT "km/h" /end MEASUREMENT
/begin MEASUREMENT gSendBuffer._373_ "array gSendBuffer" UBYTE NO_COMPU_METHOD 0 0 0 255 READ_WRITE ECU_ADDRESS 0x70001259 FORMAT "%.15" PHYS_UNIT "km/h" /end MEASUREMENT
/begin MEASUREMENT gSendBuffer._374_ "array gSendBuffer" UBYTE NO_COMPU_METHOD 0 0 0 255 READ_WRITE ECU_ADDRESS 0x7000125A FORMAT "%.15" PHYS_UNIT "km/h" /end MEASUREMENT
/begin MEASUREMENT gSendBuffer._375_ "array gSendBuffer" UBYTE NO_COMPU_METHOD 0 0 0 255 READ_WRITE ECU_ADDRESS 0x7000125B FORMAT "%.15" PHYS_UNIT "km/h" /end MEASUREMENT
/begin MEASUREMENT gSendBuffer._376_ "array gSendBuffer" UBYTE NO_COMPU_METHOD 0 0 0 255 READ_WRITE ECU_ADDRESS 0x7000125C FORMAT "%.15" PHYS_UNIT "km/h" /end MEASUREMENT
/begin MEASUREMENT gSendBuffer._377_ "array gSendBuffer" UBYTE NO_COMPU_METHOD 0 0 0 255 READ_WRITE ECU_ADDRESS 0x7000125D FORMAT "%.15" PHYS_UNIT "km/h" /end MEASUREMENT
/begin MEASUREMENT gSendBuffer._378_ "array gSendBuffer" UBYTE NO_COMPU_METHOD 0 0 0 255 READ_WRITE ECU_ADDRESS 0x7000125E FORMAT "%.15" PHYS_UNIT "km/h" /end MEASUREMENT
/begin MEASUREMENT gSendBuffer._379_ "array gSendBuffer" UBYTE NO_COMPU_METHOD 0 0 0 255 READ_WRITE ECU_ADDRESS 0x7000125F FORMAT "%.15" PHYS_UNIT "km/h" /end MEASUREMENT
/begin MEASUREMENT gSendBuffer._380_ "array gSendBuffer" UBYTE NO_COMPU_METHOD 0 0 0 255 READ_WRITE ECU_ADDRESS 0x70001260 FORMAT "%.15" PHYS_UNIT "km/h" /end MEASUREMENT
/begin MEASUREMENT gSendBuffer._381_ "array gSendBuffer" UBYTE NO_COMPU_METHOD 0 0 0 255 READ_WRITE ECU_ADDRESS 0x70001261 FORMAT "%.15" PHYS_UNIT "km/h" /end MEASUREMENT
/begin MEASUREMENT gSendBuffer._382_ "array gSendBuffer" UBYTE NO_COMPU_METHOD 0 0 0 255 READ_WRITE ECU_ADDRESS 0x70001262 FORMAT "%.15" PHYS_UNIT "km/h" /end MEASUREMENT
/begin MEASUREMENT gSendBuffer._383_ "array gSendBuffer" UBYTE NO_COMPU_METHOD 0 0 0 255 READ_WRITE ECU_ADDRESS 0x70001263 FORMAT "%.15" PHYS_UNIT "km/h" /end MEASUREMENT
/begin MEASUREMENT gSendBuffer._384_ "array gSendBuffer" UBYTE NO_COMPU_METHOD 0 0 0 255 READ_WRITE ECU_ADDRESS 0x70001264 FORMAT "%.15" PHYS_UNIT "km/h" /end MEASUREMENT
/begin MEASUREMENT gSendBuffer._385_ "array gSendBuffer" UBYTE NO_COMPU_METHOD 0 0 0 255 READ_WRITE ECU_ADDRESS 0x70001265 FORMAT "%.15" PHYS_UNIT "km/h" /end MEASUREMENT
/begin MEASUREMENT gSendBuffer._386_ "array gSendBuffer" UBYTE NO_COMPU_METHOD 0 0 0 255 READ_WRITE ECU_ADDRESS 0x70001266 FORMAT "%.15" PHYS_UNIT "km/h" /end MEASUREMENT
/begin MEASUREMENT gSendBuffer._387_ "array gSendBuffer" UBYTE NO_COMPU_METHOD 0 0 0 255 READ_WRITE ECU_ADDRESS 0x70001267 FORMAT "%.15" PHYS_UNIT "km/h" /end MEASUREMENT
/begin MEASUREMENT gSendBuffer._388_ "array gSendBuffer" UBYTE NO_COMPU_METHOD 0 0 0 255 READ_WRITE ECU_ADDRESS 0x70001268 FORMAT "%.15" PHYS_UNIT "km/h" /end MEASUREMENT
/begin MEASUREMENT gSendBuffer._389_ "array gSendBuffer" UBYTE NO_COMPU_METHOD 0 0 0 255 READ_WRITE ECU_ADDRESS 0x70001269 FORMAT "%.15" PHYS_UNIT "km/h" /end MEASUREMENT
/begin MEASUREMENT gSendBuffer._390_ "array gSendBuffer" UBYTE NO_COMPU_METHOD 0 0 0 255 READ_WRITE ECU_ADDRESS 0x7000126A FORMAT "%.15" PHYS_UNIT "km/h" /end MEASUREMENT
/begin MEASUREMENT gSendBuffer._391_ "array gSendBuffer" UBYTE NO_COMPU_METHOD 0 0 0 255 READ_WRITE ECU_ADDRESS 0x7000126B FORMAT "%.15" PHYS_UNIT "km/h" /end MEASUREMENT
/begin MEASUREMENT gSendBuffer._392_ "array gSendBuffer" UBYTE NO_COMPU_METHOD 0 0 0 255 READ_WRITE ECU_ADDRESS 0x7000126C FORMAT "%.15" PHYS_UNIT "km/h" /end MEASUREMENT
/begin MEASUREMENT gSendBuffer._393_ "array gSendBuffer" UBYTE NO_COMPU_METHOD 0 0 0 255 READ_WRITE ECU_ADDRESS 0x7000126D FORMAT "%.15" PHYS_UNIT "km/h" /end MEASUREMENT
/begin MEASUREMENT gSendBuffer._394_ "array gSendBuffer" UBYTE NO_COMPU_METHOD 0 0 0 255 READ_WRITE ECU_ADDRESS 0x7000126E FORMAT "%.15" PHYS_UNIT "km/h" /end MEASUREMENT
/begin MEASUREMENT gSendBuffer._395_ "array gSendBuffer" UBYTE NO_COMPU_METHOD 0 0 0 255 READ_WRITE ECU_ADDRESS 0x7000126F FORMAT "%.15" PHYS_UNIT "km/h" /end MEASUREMENT
/begin MEASUREMENT gSendBuffer._396_ "array gSendBuffer" UBYTE NO_COMPU_METHOD 0 0 0 255 READ_WRITE ECU_ADDRESS 0x70001270 FORMAT "%.15" PHYS_UNIT "km/h" /end MEASUREMENT
/begin MEASUREMENT gSendBuffer._397_ "array gSendBuffer" UBYTE NO_COMPU_METHOD 0 0 0 255 READ_WRITE ECU_ADDRESS 0x70001271 FORMAT "%.15" PHYS_UNIT "km/h" /end MEASUREMENT
/begin MEASUREMENT gSendBuffer._398_ "array gSendBuffer" UBYTE NO_COMPU_METHOD 0 0 0 255 READ_WRITE ECU_ADDRESS 0x70001272 FORMAT "%.15" PHYS_UNIT "km/h" /end MEASUREMENT
/begin MEASUREMENT gSendBuffer._399_ "array gSendBuffer" UBYTE NO_COMPU_METHOD 0 0 0 255 READ_WRITE ECU_ADDRESS 0x70001273 FORMAT "%.15" PHYS_UNIT "km/h" /end MEASUREMENT
/begin MEASUREMENT gSendBuffer._400_ "array gSendBuffer" UBYTE NO_COMPU_METHOD 0 0 0 255 READ_WRITE ECU_ADDRESS 0x70001274 FORMAT "%.15" PHYS_UNIT "km/h" /end MEASUREMENT
/begin MEASUREMENT gSendBuffer._401_ "array gSendBuffer" UBYTE NO_COMPU_METHOD 0 0 0 255 READ_WRITE ECU_ADDRESS 0x70001275 FORMAT "%.15" PHYS_UNIT "km/h" /end MEASUREMENT
/begin MEASUREMENT gSendBuffer._402_ "array gSendBuffer" UBYTE NO_COMPU_METHOD 0 0 0 255 READ_WRITE ECU_ADDRESS 0x70001276 FORMAT "%.15" PHYS_UNIT "km/h" /end MEASUREMENT
/begin MEASUREMENT gSendBuffer._403_ "array gSendBuffer" UBYTE NO_COMPU_METHOD 0 0 0 255 READ_WRITE ECU_ADDRESS 0x70001277 FORMAT "%.15" PHYS_UNIT "km/h" /end MEASUREMENT
/begin MEASUREMENT gSendBuffer._404_ "array gSendBuffer" UBYTE NO_COMPU_METHOD 0 0 0 255 READ_WRITE ECU_ADDRESS 0x70001278 FORMAT "%.15" PHYS_UNIT "km/h" /end MEASUREMENT
/begin MEASUREMENT gSendBuffer._405_ "array gSendBuffer" UBYTE NO_COMPU_METHOD 0 0 0 255 READ_WRITE ECU_ADDRESS 0x70001279 FORMAT "%.15" PHYS_UNIT "km/h" /end MEASUREMENT
/begin MEASUREMENT gSendBuffer._406_ "array gSendBuffer" UBYTE NO_COMPU_METHOD 0 0 0 255 READ_WRITE ECU_ADDRESS 0x7000127A FORMAT "%.15" PHYS_UNIT "km/h" /end MEASUREMENT
/begin MEASUREMENT gSendBuffer._407_ "array gSendBuffer" UBYTE NO_COMPU_METHOD 0 0 0 255 READ_WRITE ECU_ADDRESS 0x7000127B FORMAT "%.15" PHYS_UNIT "km/h" /end MEASUREMENT
/begin MEASUREMENT gSendBuffer._408_ "array gSendBuffer" UBYTE NO_COMPU_METHOD 0 0 0 255 READ_WRITE ECU_ADDRESS 0x7000127C FORMAT "%.15" PHYS_UNIT "km/h" /end MEASUREMENT
/begin MEASUREMENT gSendBuffer._409_ "array gSendBuffer" UBYTE NO_COMPU_METHOD 0 0 0 255 READ_WRITE ECU_ADDRESS 0x7000127D FORMAT "%.15" PHYS_UNIT "km/h" /end MEASUREMENT
/begin MEASUREMENT gSendBuffer._410_ "array gSendBuffer" UBYTE NO_COMPU_METHOD 0 0 0 255 READ_WRITE ECU_ADDRESS 0x7000127E FORMAT "%.15" PHYS_UNIT "km/h" /end MEASUREMENT
/begin MEASUREMENT gSendBuffer._411_ "array gSendBuffer" UBYTE NO_COMPU_METHOD 0 0 0 255 READ_WRITE ECU_ADDRESS 0x7000127F FORMAT "%.15" PHYS_UNIT "km/h" /end MEASUREMENT
/begin MEASUREMENT gSendBuffer._412_ "array gSendBuffer" UBYTE NO_COMPU_METHOD 0 0 0 255 READ_WRITE ECU_ADDRESS 0x70001280 FORMAT "%.15" PHYS_UNIT "km/h" /end MEASUREMENT
/begin MEASUREMENT gSendBuffer._413_ "array gSendBuffer" UBYTE NO_COMPU_METHOD 0 0 0 255 READ_WRITE ECU_ADDRESS 0x70001281 FORMAT "%.15" PHYS_UNIT "km/h" /end MEASUREMENT
/begin MEASUREMENT gSendBuffer._414_ "array gSendBuffer" UBYTE NO_COMPU_METHOD 0 0 0 255 READ_WRITE ECU_ADDRESS 0x70001282 FORMAT "%.15" PHYS_UNIT "km/h" /end MEASUREMENT
/begin MEASUREMENT gSendBuffer._415_ "array gSendBuffer" UBYTE NO_COMPU_METHOD 0 0 0 255 READ_WRITE ECU_ADDRESS 0x70001283 FORMAT "%.15" PHYS_UNIT "km/h" /end MEASUREMENT
/begin MEASUREMENT gSendBuffer._416_ "array gSendBuffer" UBYTE NO_COMPU_METHOD 0 0 0 255 READ_WRITE ECU_ADDRESS 0x70001284 FORMAT "%.15" PHYS_UNIT "km/h" /end MEASUREMENT
/begin MEASUREMENT gSendBuffer._417_ "array gSendBuffer" UBYTE NO_COMPU_METHOD 0 0 0 255 READ_WRITE ECU_ADDRESS 0x70001285 FORMAT "%.15" PHYS_UNIT "km/h" /end MEASUREMENT
/begin MEASUREMENT gSendBuffer._418_ "array gSendBuffer" UBYTE NO_COMPU_METHOD 0 0 0 255 READ_WRITE ECU_ADDRESS 0x70001286 FORMAT "%.15" PHYS_UNIT "km/h" /end MEASUREMENT
/begin MEASUREMENT gSendBuffer._419_ "array gSendBuffer" UBYTE NO_COMPU_METHOD 0 0 0 255 READ_WRITE ECU_ADDRESS 0x70001287 FORMAT "%.15" PHYS_UNIT "km/h" /end MEASUREMENT
/begin MEASUREMENT gSendBuffer._420_ "array gSendBuffer" UBYTE NO_COMPU_METHOD 0 0 0 255 READ_WRITE ECU_ADDRESS 0x70001288 FORMAT "%.15" PHYS_UNIT "km/h" /end MEASUREMENT
/begin MEASUREMENT gSendBuffer._421_ "array gSendBuffer" UBYTE NO_COMPU_METHOD 0 0 0 255 READ_WRITE ECU_ADDRESS 0x70001289 FORMAT "%.15" PHYS_UNIT "km/h" /end MEASUREMENT
/begin MEASUREMENT gSendBuffer._422_ "array gSendBuffer" UBYTE NO_COMPU_METHOD 0 0 0 255 READ_WRITE ECU_ADDRESS 0x7000128A FORMAT "%.15" PHYS_UNIT "km/h" /end MEASUREMENT
/begin MEASUREMENT gSendBuffer._423_ "array gSendBuffer" UBYTE NO_COMPU_METHOD 0 0 0 255 READ_WRITE ECU_ADDRESS 0x7000128B FORMAT "%.15" PHYS_UNIT "km/h" /end MEASUREMENT
/begin MEASUREMENT gSendBuffer._424_ "array gSendBuffer" UBYTE NO_COMPU_METHOD 0 0 0 255 READ_WRITE ECU_ADDRESS 0x7000128C FORMAT "%.15" PHYS_UNIT "km/h" /end MEASUREMENT
/begin MEASUREMENT gSendBuffer._425_ "array gSendBuffer" UBYTE NO_COMPU_METHOD 0 0 0 255 READ_WRITE ECU_ADDRESS 0x7000128D FORMAT "%.15" PHYS_UNIT "km/h" /end MEASUREMENT
/begin MEASUREMENT gSendBuffer._426_ "array gSendBuffer" UBYTE NO_COMPU_METHOD 0 0 0 255 READ_WRITE ECU_ADDRESS 0x7000128E FORMAT "%.15" PHYS_UNIT "km/h" /end MEASUREMENT
/begin MEASUREMENT gSendBuffer._427_ "array gSendBuffer" UBYTE NO_COMPU_METHOD 0 0 0 255 READ_WRITE ECU_ADDRESS 0x7000128F FORMAT "%.15" PHYS_UNIT "km/h" /end MEASUREMENT
/begin MEASUREMENT gSendBuffer._428_ "array gSendBuffer" UBYTE NO_COMPU_METHOD 0 0 0 255 READ_WRITE ECU_ADDRESS 0x70001290 FORMAT "%.15" PHYS_UNIT "km/h" /end MEASUREMENT
/begin MEASUREMENT gSendBuffer._429_ "array gSendBuffer" UBYTE NO_COMPU_METHOD 0 0 0 255 READ_WRITE ECU_ADDRESS 0x70001291 FORMAT "%.15" PHYS_UNIT "km/h" /end MEASUREMENT
/begin MEASUREMENT gSendBuffer._430_ "array gSendBuffer" UBYTE NO_COMPU_METHOD 0 0 0 255 READ_WRITE ECU_ADDRESS 0x70001292 FORMAT "%.15" PHYS_UNIT "km/h" /end MEASUREMENT
/begin MEASUREMENT gSendBuffer._431_ "array gSendBuffer" UBYTE NO_COMPU_METHOD 0 0 0 255 READ_WRITE ECU_ADDRESS 0x70001293 FORMAT "%.15" PHYS_UNIT "km/h" /end MEASUREMENT
/begin MEASUREMENT gSendBuffer._432_ "array gSendBuffer" UBYTE NO_COMPU_METHOD 0 0 0 255 READ_WRITE ECU_ADDRESS 0x70001294 FORMAT "%.15" PHYS_UNIT "km/h" /end MEASUREMENT
/begin MEASUREMENT gSendBuffer._433_ "array gSendBuffer" UBYTE NO_COMPU_METHOD 0 0 0 255 READ_WRITE ECU_ADDRESS 0x70001295 FORMAT "%.15" PHYS_UNIT "km/h" /end MEASUREMENT
/begin MEASUREMENT gSendBuffer._434_ "array gSendBuffer" UBYTE NO_COMPU_METHOD 0 0 0 255 READ_WRITE ECU_ADDRESS 0x70001296 FORMAT "%.15" PHYS_UNIT "km/h" /end MEASUREMENT
/begin MEASUREMENT gSendBuffer._435_ "array gSendBuffer" UBYTE NO_COMPU_METHOD 0 0 0 255 READ_WRITE ECU_ADDRESS 0x70001297 FORMAT "%.15" PHYS_UNIT "km/h" /end MEASUREMENT
/begin MEASUREMENT gSendBuffer._436_ "array gSendBuffer" UBYTE NO_COMPU_METHOD 0 0 0 255 READ_WRITE ECU_ADDRESS 0x70001298 FORMAT "%.15" PHYS_UNIT "km/h" /end MEASUREMENT
/begin MEASUREMENT gSendBuffer._437_ "array gSendBuffer" UBYTE NO_COMPU_METHOD 0 0 0 255 READ_WRITE ECU_ADDRESS 0x70001299 FORMAT "%.15" PHYS_UNIT "km/h" /end MEASUREMENT
/begin MEASUREMENT gSendBuffer._438_ "array gSendBuffer" UBYTE NO_COMPU_METHOD 0 0 0 255 READ_WRITE ECU_ADDRESS 0x7000129A FORMAT "%.15" PHYS_UNIT "km/h" /end MEASUREMENT
/begin MEASUREMENT gSendBuffer._439_ "array gSendBuffer" UBYTE NO_COMPU_METHOD 0 0 0 255 READ_WRITE ECU_ADDRESS 0x7000129B FORMAT "%.15" PHYS_UNIT "km/h" /end MEASUREMENT
/begin MEASUREMENT gSendBuffer._440_ "array gSendBuffer" UBYTE NO_COMPU_METHOD 0 0 0 255 READ_WRITE ECU_ADDRESS 0x7000129C FORMAT "%.15" PHYS_UNIT "km/h" /end MEASUREMENT
/begin MEASUREMENT gSendBuffer._441_ "array gSendBuffer" UBYTE NO_COMPU_METHOD 0 0 0 255 READ_WRITE ECU_ADDRESS 0x7000129D FORMAT "%.15" PHYS_UNIT "km/h" /end MEASUREMENT
/begin MEASUREMENT gSendBuffer._442_ "array gSendBuffer" UBYTE NO_COMPU_METHOD 0 0 0 255 READ_WRITE ECU_ADDRESS 0x7000129E FORMAT "%.15" PHYS_UNIT "km/h" /end MEASUREMENT
/begin MEASUREMENT gSendBuffer._443_ "array gSendBuffer" UBYTE NO_COMPU_METHOD 0 0 0 255 READ_WRITE ECU_ADDRESS 0x7000129F FORMAT "%.15" PHYS_UNIT "km/h" /end MEASUREMENT
/begin MEASUREMENT gSendBuffer._444_ "array gSendBuffer" UBYTE NO_COMPU_METHOD 0 0 0 255 READ_WRITE ECU_ADDRESS 0x700012A0 FORMAT "%.15" PHYS_UNIT "km/h" /end MEASUREMENT
/begin MEASUREMENT gSendBuffer._445_ "array gSendBuffer" UBYTE NO_COMPU_METHOD 0 0 0 255 READ_WRITE ECU_ADDRESS 0x700012A1 FORMAT "%.15" PHYS_UNIT "km/h" /end MEASUREMENT
/begin MEASUREMENT gSendBuffer._446_ "array gSendBuffer" UBYTE NO_COMPU_METHOD 0 0 0 255 READ_WRITE ECU_ADDRESS 0x700012A2 FORMAT "%.15" PHYS_UNIT "km/h" /end MEASUREMENT
/begin MEASUREMENT gSendBuffer._447_ "array gSendBuffer" UBYTE NO_COMPU_METHOD 0 0 0 255 READ_WRITE ECU_ADDRESS 0x700012A3 FORMAT "%.15" PHYS_UNIT "km/h" /end MEASUREMENT
/begin MEASUREMENT gSendBuffer._448_ "array gSendBuffer" UBYTE NO_COMPU_METHOD 0 0 0 255 READ_WRITE ECU_ADDRESS 0x700012A4 FORMAT "%.15" PHYS_UNIT "km/h" /end MEASUREMENT
/begin MEASUREMENT gSendBuffer._449_ "array gSendBuffer" UBYTE NO_COMPU_METHOD 0 0 0 255 READ_WRITE ECU_ADDRESS 0x700012A5 FORMAT "%.15" PHYS_UNIT "km/h" /end MEASUREMENT
/begin MEASUREMENT gSendBuffer._450_ "array gSendBuffer" UBYTE NO_COMPU_METHOD 0 0 0 255 READ_WRITE ECU_ADDRESS 0x700012A6 FORMAT "%.15" PHYS_UNIT "km/h" /end MEASUREMENT
/begin MEASUREMENT gSendBuffer._451_ "array gSendBuffer" UBYTE NO_COMPU_METHOD 0 0 0 255 READ_WRITE ECU_ADDRESS 0x700012A7 FORMAT "%.15" PHYS_UNIT "km/h" /end MEASUREMENT
/begin MEASUREMENT gSendBuffer._452_ "array gSendBuffer" UBYTE NO_COMPU_METHOD 0 0 0 255 READ_WRITE ECU_ADDRESS 0x700012A8 FORMAT "%.15" PHYS_UNIT "km/h" /end MEASUREMENT
/begin MEASUREMENT gSendBuffer._453_ "array gSendBuffer" UBYTE NO_COMPU_METHOD 0 0 0 255 READ_WRITE ECU_ADDRESS 0x700012A9 FORMAT "%.15" PHYS_UNIT "km/h" /end MEASUREMENT
/begin MEASUREMENT gSendBuffer._454_ "array gSendBuffer" UBYTE NO_COMPU_METHOD 0 0 0 255 READ_WRITE ECU_ADDRESS 0x700012AA FORMAT "%.15" PHYS_UNIT "km/h" /end MEASUREMENT
/begin MEASUREMENT gSendBuffer._455_ "array gSendBuffer" UBYTE NO_COMPU_METHOD 0 0 0 255 READ_WRITE ECU_ADDRESS 0x700012AB FORMAT "%.15" PHYS_UNIT "km/h" /end MEASUREMENT
/begin MEASUREMENT gSendBuffer._456_ "array gSendBuffer" UBYTE NO_COMPU_METHOD 0 0 0 255 READ_WRITE ECU_ADDRESS 0x700012AC FORMAT "%.15" PHYS_UNIT "km/h" /end MEASUREMENT
/begin MEASUREMENT gSendBuffer._457_ "array gSendBuffer" UBYTE NO_COMPU_METHOD 0 0 0 255 READ_WRITE ECU_ADDRESS 0x700012AD FORMAT "%.15" PHYS_UNIT "km/h" /end MEASUREMENT
/begin MEASUREMENT gSendBuffer._458_ "array gSendBuffer" UBYTE NO_COMPU_METHOD 0 0 0 255 READ_WRITE ECU_ADDRESS 0x700012AE FORMAT "%.15" PHYS_UNIT "km/h" /end MEASUREMENT
/begin MEASUREMENT gSendBuffer._459_ "array gSendBuffer" UBYTE NO_COMPU_METHOD 0 0 0 255 READ_WRITE ECU_ADDRESS 0x700012AF FORMAT "%.15" PHYS_UNIT "km/h" /end MEASUREMENT
/begin MEASUREMENT gSendBuffer._460_ "array gSendBuffer" UBYTE NO_COMPU_METHOD 0 0 0 255 READ_WRITE ECU_ADDRESS 0x700012B0 FORMAT "%.15" PHYS_UNIT "km/h" /end MEASUREMENT
/begin MEASUREMENT gSendBuffer._461_ "array gSendBuffer" UBYTE NO_COMPU_METHOD 0 0 0 255 READ_WRITE ECU_ADDRESS 0x700012B1 FORMAT "%.15" PHYS_UNIT "km/h" /end MEASUREMENT
/begin MEASUREMENT gSendBuffer._462_ "array gSendBuffer" UBYTE NO_COMPU_METHOD 0 0 0 255 READ_WRITE ECU_ADDRESS 0x700012B2 FORMAT "%.15" PHYS_UNIT "km/h" /end MEASUREMENT
/begin MEASUREMENT gSendBuffer._463_ "array gSendBuffer" UBYTE NO_COMPU_METHOD 0 0 0 255 READ_WRITE ECU_ADDRESS 0x700012B3 FORMAT "%.15" PHYS_UNIT "km/h" /end MEASUREMENT
/begin MEASUREMENT gSendBuffer._464_ "array gSendBuffer" UBYTE NO_COMPU_METHOD 0 0 0 255 READ_WRITE ECU_ADDRESS 0x700012B4 FORMAT "%.15" PHYS_UNIT "km/h" /end MEASUREMENT
/begin MEASUREMENT gSendBuffer._465_ "array gSendBuffer" UBYTE NO_COMPU_METHOD 0 0 0 255 READ_WRITE ECU_ADDRESS 0x700012B5 FORMAT "%.15" PHYS_UNIT "km/h" /end MEASUREMENT
/begin MEASUREMENT gSendBuffer._466_ "array gSendBuffer" UBYTE NO_COMPU_METHOD 0 0 0 255 READ_WRITE ECU_ADDRESS 0x700012B6 FORMAT "%.15" PHYS_UNIT "km/h" /end MEASUREMENT
/begin MEASUREMENT gSendBuffer._467_ "array gSendBuffer" UBYTE NO_COMPU_METHOD 0 0 0 255 READ_WRITE ECU_ADDRESS 0x700012B7 FORMAT "%.15" PHYS_UNIT "km/h" /end MEASUREMENT
/begin MEASUREMENT gSendBuffer._468_ "array gSendBuffer" UBYTE NO_COMPU_METHOD 0 0 0 255 READ_WRITE ECU_ADDRESS 0x700012B8 FORMAT "%.15" PHYS_UNIT "km/h" /end MEASUREMENT
/begin MEASUREMENT gSendBuffer._469_ "array gSendBuffer" UBYTE NO_COMPU_METHOD 0 0 0 255 READ_WRITE ECU_ADDRESS 0x700012B9 FORMAT "%.15" PHYS_UNIT "km/h" /end MEASUREMENT
/begin MEASUREMENT gSendBuffer._470_ "array gSendBuffer" UBYTE NO_COMPU_METHOD 0 0 0 255 READ_WRITE ECU_ADDRESS 0x700012BA FORMAT "%.15" PHYS_UNIT "km/h" /end MEASUREMENT
/begin MEASUREMENT gSendBuffer._471_ "array gSendBuffer" UBYTE NO_COMPU_METHOD 0 0 0 255 READ_WRITE ECU_ADDRESS 0x700012BB FORMAT "%.15" PHYS_UNIT "km/h" /end MEASUREMENT
/begin MEASUREMENT gSendBuffer._472_ "array gSendBuffer" UBYTE NO_COMPU_METHOD 0 0 0 255 READ_WRITE ECU_ADDRESS 0x700012BC FORMAT "%.15" PHYS_UNIT "km/h" /end MEASUREMENT
/begin MEASUREMENT gSendBuffer._473_ "array gSendBuffer" UBYTE NO_COMPU_METHOD 0 0 0 255 READ_WRITE ECU_ADDRESS 0x700012BD FORMAT "%.15" PHYS_UNIT "km/h" /end MEASUREMENT
/begin MEASUREMENT gSendBuffer._474_ "array gSendBuffer" UBYTE NO_COMPU_METHOD 0 0 0 255 READ_WRITE ECU_ADDRESS 0x700012BE FORMAT "%.15" PHYS_UNIT "km/h" /end MEASUREMENT
/begin MEASUREMENT gSendBuffer._475_ "array gSendBuffer" UBYTE NO_COMPU_METHOD 0 0 0 255 READ_WRITE ECU_ADDRESS 0x700012BF FORMAT "%.15" PHYS_UNIT "km/h" /end MEASUREMENT
/begin MEASUREMENT gSendBuffer._476_ "array gSendBuffer" UBYTE NO_COMPU_METHOD 0 0 0 255 READ_WRITE ECU_ADDRESS 0x700012C0 FORMAT "%.15" PHYS_UNIT "km/h" /end MEASUREMENT
/begin MEASUREMENT gSendBuffer._477_ "array gSendBuffer" UBYTE NO_COMPU_METHOD 0 0 0 255 READ_WRITE ECU_ADDRESS 0x700012C1 FORMAT "%.15" PHYS_UNIT "km/h" /end MEASUREMENT
/begin MEASUREMENT gSendBuffer._478_ "array gSendBuffer" UBYTE NO_COMPU_METHOD 0 0 0 255 READ_WRITE ECU_ADDRESS 0x700012C2 FORMAT "%.15" PHYS_UNIT "km/h" /end MEASUREMENT
/begin MEASUREMENT gSendBuffer._479_ "array gSendBuffer" UBYTE NO_COMPU_METHOD 0 0 0 255 READ_WRITE ECU_ADDRESS 0x700012C3 FORMAT "%.15" PHYS_UNIT "km/h" /end MEASUREMENT
/begin MEASUREMENT gSendBuffer._480_ "array gSendBuffer" UBYTE NO_COMPU_METHOD 0 0 0 255 READ_WRITE ECU_ADDRESS 0x700012C4 FORMAT "%.15" PHYS_UNIT "km/h" /end MEASUREMENT
/begin MEASUREMENT gSendBuffer._481_ "array gSendBuffer" UBYTE NO_COMPU_METHOD 0 0 0 255 READ_WRITE ECU_ADDRESS 0x700012C5 FORMAT "%.15" PHYS_UNIT "km/h" /end MEASUREMENT
/begin MEASUREMENT gSendBuffer._482_ "array gSendBuffer" UBYTE NO_COMPU_METHOD 0 0 0 255 READ_WRITE ECU_ADDRESS 0x700012C6 FORMAT "%.15" PHYS_UNIT "km/h" /end MEASUREMENT
/begin MEASUREMENT gSendBuffer._483_ "array gSendBuffer" UBYTE NO_COMPU_METHOD 0 0 0 255 READ_WRITE ECU_ADDRESS 0x700012C7 FORMAT "%.15" PHYS_UNIT "km/h" /end MEASUREMENT
/begin MEASUREMENT gSendBuffer._484_ "array gSendBuffer" UBYTE NO_COMPU_METHOD 0 0 0 255 READ_WRITE ECU_ADDRESS 0x700012C8 FORMAT "%.15" PHYS_UNIT "km/h" /end MEASUREMENT
/begin MEASUREMENT gSendBuffer._485_ "array gSendBuffer" UBYTE NO_COMPU_METHOD 0 0 0 255 READ_WRITE ECU_ADDRESS 0x700012C9 FORMAT "%.15" PHYS_UNIT "km/h" /end MEASUREMENT
/begin MEASUREMENT gSendBuffer._486_ "array gSendBuffer" UBYTE NO_COMPU_METHOD 0 0 0 255 READ_WRITE ECU_ADDRESS 0x700012CA FORMAT "%.15" PHYS_UNIT "km/h" /end MEASUREMENT
/begin MEASUREMENT gSendBuffer._487_ "array gSendBuffer" UBYTE NO_COMPU_METHOD 0 0 0 255 READ_WRITE ECU_ADDRESS 0x700012CB FORMAT "%.15" PHYS_UNIT "km/h" /end MEASUREMENT
/begin MEASUREMENT gSendBuffer._488_ "array gSendBuffer" UBYTE NO_COMPU_METHOD 0 0 0 255 READ_WRITE ECU_ADDRESS 0x700012CC FORMAT "%.15" PHYS_UNIT "km/h" /end MEASUREMENT
/begin MEASUREMENT gSendBuffer._489_ "array gSendBuffer" UBYTE NO_COMPU_METHOD 0 0 0 255 READ_WRITE ECU_ADDRESS 0x700012CD FORMAT "%.15" PHYS_UNIT "km/h" /end MEASUREMENT
/begin MEASUREMENT gSendBuffer._490_ "array gSendBuffer" UBYTE NO_COMPU_METHOD 0 0 0 255 READ_WRITE ECU_ADDRESS 0x700012CE FORMAT "%.15" PHYS_UNIT "km/h" /end MEASUREMENT
/begin MEASUREMENT gSendBuffer._491_ "array gSendBuffer" UBYTE NO_COMPU_METHOD 0 0 0 255 READ_WRITE ECU_ADDRESS 0x700012CF FORMAT "%.15" PHYS_UNIT "km/h" /end MEASUREMENT
/begin MEASUREMENT gSendBuffer._492_ "array gSendBuffer" UBYTE NO_COMPU_METHOD 0 0 0 255 READ_WRITE ECU_ADDRESS 0x700012D0 FORMAT "%.15" PHYS_UNIT "km/h" /end MEASUREMENT
/begin MEASUREMENT gSendBuffer._493_ "array gSendBuffer" UBYTE NO_COMPU_METHOD 0 0 0 255 READ_WRITE ECU_ADDRESS 0x700012D1 FORMAT "%.15" PHYS_UNIT "km/h" /end MEASUREMENT
/begin MEASUREMENT gSendBuffer._494_ "array gSendBuffer" UBYTE NO_COMPU_METHOD 0 0 0 255 READ_WRITE ECU_ADDRESS 0x700012D2 FORMAT "%.15" PHYS_UNIT "km/h" /end MEASUREMENT
/begin MEASUREMENT gSendBuffer._495_ "array gSendBuffer" UBYTE NO_COMPU_METHOD 0 0 0 255 READ_WRITE ECU_ADDRESS 0x700012D3 FORMAT "%.15" PHYS_UNIT "km/h" /end MEASUREMENT
/begin MEASUREMENT gSendBuffer._496_ "array gSendBuffer" UBYTE NO_COMPU_METHOD 0 0 0 255 READ_WRITE ECU_ADDRESS 0x700012D4 FORMAT "%.15" PHYS_UNIT "km/h" /end MEASUREMENT
/begin MEASUREMENT gSendBuffer._497_ "array gSendBuffer" UBYTE NO_COMPU_METHOD 0 0 0 255 READ_WRITE ECU_ADDRESS 0x700012D5 FORMAT "%.15" PHYS_UNIT "km/h" /end MEASUREMENT
/begin MEASUREMENT gSendBuffer._498_ "array gSendBuffer" UBYTE NO_COMPU_METHOD 0 0 0 255 READ_WRITE ECU_ADDRESS 0x700012D6 FORMAT "%.15" PHYS_UNIT "km/h" /end MEASUREMENT
/begin MEASUREMENT gSendBuffer._499_ "array gSendBuffer" UBYTE NO_COMPU_METHOD 0 0 0 255 READ_WRITE ECU_ADDRESS 0x700012D7 FORMAT "%.15" PHYS_UNIT "km/h" /end MEASUREMENT
/begin MEASUREMENT gSendBuffer._500_ "array gSendBuffer" UBYTE NO_COMPU_METHOD 0 0 0 255 READ_WRITE ECU_ADDRESS 0x700012D8 FORMAT "%.15" PHYS_UNIT "km/h" /end MEASUREMENT
/begin MEASUREMENT gSendBuffer._501_ "array gSendBuffer" UBYTE NO_COMPU_METHOD 0 0 0 255 READ_WRITE ECU_ADDRESS 0x700012D9 FORMAT "%.15" PHYS_UNIT "km/h" /end MEASUREMENT
/begin MEASUREMENT gSendBuffer._502_ "array gSendBuffer" UBYTE NO_COMPU_METHOD 0 0 0 255 READ_WRITE ECU_ADDRESS 0x700012DA FORMAT "%.15" PHYS_UNIT "km/h" /end MEASUREMENT
/begin MEASUREMENT gSendBuffer._503_ "array gSendBuffer" UBYTE NO_COMPU_METHOD 0 0 0 255 READ_WRITE ECU_ADDRESS 0x700012DB FORMAT "%.15" PHYS_UNIT "km/h" /end MEASUREMENT
/begin MEASUREMENT gSendBuffer._504_ "array gSendBuffer" UBYTE NO_COMPU_METHOD 0 0 0 255 READ_WRITE ECU_ADDRESS 0x700012DC FORMAT "%.15" PHYS_UNIT "km/h" /end MEASUREMENT
/begin MEASUREMENT gSendBuffer._505_ "array gSendBuffer" UBYTE NO_COMPU_METHOD 0 0 0 255 READ_WRITE ECU_ADDRESS 0x700012DD FORMAT "%.15" PHYS_UNIT "km/h" /end MEASUREMENT
/begin MEASUREMENT gSendBuffer._506_ "array gSendBuffer" UBYTE NO_COMPU_METHOD 0 0 0 255 READ_WRITE ECU_ADDRESS 0x700012DE FORMAT "%.15" PHYS_UNIT "km/h" /end MEASUREMENT
/begin MEASUREMENT gSendBuffer._507_ "array gSendBuffer" UBYTE NO_COMPU_METHOD 0 0 0 255 READ_WRITE ECU_ADDRESS 0x700012DF FORMAT "%.15" PHYS_UNIT "km/h" /end MEASUREMENT
/begin MEASUREMENT gSendBuffer._508_ "array gSendBuffer" UBYTE NO_COMPU_METHOD 0 0 0 255 READ_WRITE ECU_ADDRESS 0x700012E0 FORMAT "%.15" PHYS_UNIT "km/h" /end MEASUREMENT
/begin MEASUREMENT gSendBuffer._509_ "array gSendBuffer" UBYTE NO_COMPU_METHOD 0 0 0 255 READ_WRITE ECU_ADDRESS 0x700012E1 FORMAT "%.15" PHYS_UNIT "km/h" /end MEASUREMENT
/begin MEASUREMENT gSendBuffer._510_ "array gSendBuffer" UBYTE NO_COMPU_METHOD 0 0 0 255 READ_WRITE ECU_ADDRESS 0x700012E2 FORMAT "%.15" PHYS_UNIT "km/h" /end MEASUREMENT
/begin MEASUREMENT gSendBuffer._511_ "array gSendBuffer" UBYTE NO_COMPU_METHOD 0 0 0 255 READ_WRITE ECU_ADDRESS 0x700012E3 FORMAT "%.15" PHYS_UNIT "km/h" /end MEASUREMENT
/begin MEASUREMENT testStruct__element "struct test" SLONG NO_COMPU_METHOD 0 0 0 255 READ_WRITE ECU_ADDRESS 0x70000E74 FORMAT "%.15" PHYS_UNIT "km/h" /end MEASUREMENT
/begin RECORD_LAYOUT __UBYTE_Z FNC_VALUES 1 UBYTE ROW_DIR DIRECT /end RECORD_LAYOUT
/begin RECORD_LAYOUT __UWORD_Z FNC_VALUES 1 UWORD ROW_DIR DIRECT /end RECORD_LAYOUT
/begin RECORD_LAYOUT __ULONG_Z FNC_VALUES 1 ULONG ROW_DIR DIRECT /end RECORD_LAYOUT
/begin RECORD_LAYOUT __SBYTE_Z FNC_VALUES 1 SBYTE ROW_DIR DIRECT /end RECORD_LAYOUT
/begin RECORD_LAYOUT __SWORD_Z FNC_VALUES 1 SWORD ROW_DIR DIRECT /end RECORD_LAYOUT
/begin RECORD_LAYOUT __SLONG_Z FNC_VALUES 1 SLONG ROW_DIR DIRECT /end RECORD_LAYOUT
/begin RECORD_LAYOUT __FLOAT32_IEEE_Z FNC_VALUES 1 FLOAT32_IEEE ROW_DIR DIRECT /end RECORD_LAYOUT
/begin RECORD_LAYOUT __FLOAT64_IEEE_Z FNC_VALUES 1 FLOAT64_IEEE ROW_DIR DIRECT /end RECORD_LAYOUT
/begin RECORD_LAYOUT __UBYTE_S FNC_VALUES 1 UBYTE COLUMN_DIR DIRECT /end RECORD_LAYOUT
/begin RECORD_LAYOUT __UWORD_S FNC_VALUES 1 UWORD COLUMN_DIR DIRECT /end RECORD_LAYOUT
/begin RECORD_LAYOUT __ULONG_S FNC_VALUES 1 ULONG COLUMN_DIR DIRECT /end RECORD_LAYOUT
/begin RECORD_LAYOUT __SBYTE_S FNC_VALUES 1 SBYTE COLUMN_DIR DIRECT /end RECORD_LAYOUT
/begin RECORD_LAYOUT __SWORD_S FNC_VALUES 1 SWORD COLUMN_DIR DIRECT /end RECORD_LAYOUT
/begin RECORD_LAYOUT __SLONG_S FNC_VALUES 1 SLONG COLUMN_DIR DIRECT /end RECORD_LAYOUT
/begin RECORD_LAYOUT __FLOAT32_IEEE_S FNC_VALUES 1 FLOAT32_IEEE COLUMN_DIR DIRECT /end RECORD_LAYOUT
/begin RECORD_LAYOUT __FLOAT64_IEEE_S FNC_VALUES 1 FLOAT64_IEEE COLUMN_DIR DIRECT /end RECORD_LAYOUT
/begin RECORD_LAYOUT SSV__UBYTE_S AXIS_PTS_X 1 UBYTE INDEX_INCR DIRECT /end RECORD_LAYOUT
/begin RECORD_LAYOUT SSV__UWORD_S AXIS_PTS_X 1 UWORD INDEX_INCR DIRECT /end RECORD_LAYOUT
/begin RECORD_LAYOUT SSV__ULONG_S AXIS_PTS_X 1 ULONG INDEX_INCR DIRECT /end RECORD_LAYOUT
/begin RECORD_LAYOUT SSV__SBYTE_S AXIS_PTS_X 1 SBYTE INDEX_INCR DIRECT /end RECORD_LAYOUT
/begin RECORD_LAYOUT SSV__SWORD_S AXIS_PTS_X 1 SWORD INDEX_INCR DIRECT /end RECORD_LAYOUT
/begin RECORD_LAYOUT SSV__SLONG_S AXIS_PTS_X 1 SLONG INDEX_INCR DIRECT /end RECORD_LAYOUT
/begin RECORD_LAYOUT SSV__FLOAT32_IEEE_S AXIS_PTS_X 1 FLOAT32_IEEE INDEX_INCR DIRECT /end RECORD_LAYOUT
/begin RECORD_LAYOUT SSV__FLOAT64_IEEE_S AXIS_PTS_X 1 FLOAT64_IEEE INDEX_INCR DIRECT /end RECORD_LAYOUT
/begin RECORD_LAYOUT __A_UINT64_Z FNC_VALUES 1 A_UINT64 ROW_DIR DIRECT /end RECORD_LAYOUT
/begin RECORD_LAYOUT __A_INT64_Z FNC_VALUES 1 A_INT64 ROW_DIR DIRECT /end RECORD_LAYOUT
/begin RECORD_LAYOUT __A_UINT64_S FNC_VALUES 1 A_UINT64 COLUMN_DIR DIRECT /end RECORD_LAYOUT
/begin RECORD_LAYOUT __A_INT64_S FNC_VALUES 1 A_INT64 COLUMN_DIR DIRECT /end RECORD_LAYOUT
/begin RECORD_LAYOUT SSV__A_UINT64_S AXIS_PTS_X 1 A_UINT64 INDEX_INCR DIRECT /end RECORD_LAYOUT
/begin RECORD_LAYOUT SSV__A_INT64_S AXIS_PTS_X 1 A_INT64 INDEX_INCR DIRECT /end RECORD_LAYOUT
/end MODULE
/end PROJECT
